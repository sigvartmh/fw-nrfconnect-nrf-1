## prj.conf
```kconfig
# Heap
CONFIG_HEAP_MEM_POOL_SIZE=4096

# Required for image confirmation
CONFIG_BOOTLOADER_MCUBOOT=y
CONFIG_IMG_MANAGER=y
CONFIG_MCUBOOT_IMG_MANAGER=y
CONFIG_IMG_ERASE_PROGRESSIVELY=y
CONFIG_FLASH=y
CONFIG_MPU_ALLOW_FLASH_WRITE=y
#CONFIG_SECURE_BOOT=y
CONFIG_DFU_MULTI_IMAGE=n
```

## src/main.c
```c
/*
 * Copyright (c) 2012-2014 Wind River Systems, Inc.
 *
 * SPDX-License-Identifier: Apache-2.0
 */
#include <zephyr/kernel.h>
#include <zephyr/dfu/mcuboot.h>

#include <pm_config.h>

void find_executing_slot(int* slot);

void main(void)
{
    int ret = 0;
	struct mcuboot_img_header mcuboot_header;
    ret = boot_read_bank_header(PM_MCUBOOT_PRIMARY_ID,
		    &mcuboot_header,
		    sizeof(mcuboot_header));
    if (ret != 0) {
	printk("Failed to read bank header");
    } else {
    printk("\nHello Confirm!: %d,%d,%d\n",
		mcuboot_header.h.v1.sem_ver.major,
		mcuboot_header.h.v1.sem_ver.minor,
		mcuboot_header.h.v1.sem_ver.revision
	  );
    }

    ret = boot_write_img_confirmed();
    printk("Image confirmation returned: %d\n", ret);
}
```

## src/nrf_custom_hooks.c
```c
/*
 * Copyright (c) 2021 Nordic Semiconductor ASA
 *
 * SPDX-License-Identifier: LicenseRef-Nordic-5-Clause
 */

#include <assert.h>
#include <zephyr/kernel.h>
#include <zephyr/device.h>
#include <zephyr/devicetree.h>
#include <zephyr/drivers/flash/flash_simulator.h>
#include "bootutil/image.h"
#include "bootutil/bootutil.h"
#include "bootutil/fault_injection_hardening.h"
#include "flash_map_backend/flash_map_backend.h"

#define SECONDARY_SLOT_1 1
#define PRIMARY_SLOT_1 3

#include <dfu/pcd.h>

int boot_read_image_header_hook(int img_index, int slot,
		struct image_header *img_head)
{
	if (img_index == 1 && slot == 0) {
		img_head->ih_magic = IMAGE_MAGIC;
		img_head->ih_hdr_size = PM_MCUBOOT_PAD_SIZE;
		img_head->ih_load_addr = PM_MCUBOOT_PRIMARY_1_ADDRESS;
		img_head->ih_img_size = PM_MCUBOOT_PRIMARY_1_SIZE-PM_MCUBOOT_PAD_SIZE - sizeof(IMAGE_MAGIC);
		img_head->ih_flags = 0;
		img_head->ih_ver.iv_major = 0;
		img_head->ih_ver.iv_minor = 0;
		img_head->ih_ver.iv_revision = 0;
		img_head->ih_ver.iv_build_num = 0;
		img_head->_pad1 = 0;
		return 0;
	}
	else if (img_index == 1 && slot == 1) {
		img_head->ih_magic = IMAGE_MAGIC;
		img_head->ih_hdr_size = PM_MCUBOOT_PAD_SIZE;
		img_head->ih_load_addr = PM_MCUBOOT_SECONDARY_1_ADDRESS;
		img_head->ih_img_size = PM_MCUBOOT_SECONDARY_1_SIZE-PM_MCUBOOT_PAD_SIZE - sizeof(IMAGE_MAGIC);
		img_head->ih_flags = 0;
		img_head->ih_ver.iv_major = 0;
		img_head->ih_ver.iv_minor = 0;
		img_head->ih_ver.iv_revision = 0;
		img_head->ih_ver.iv_build_num = 0;
		img_head->_pad1 = 0;
		return 0;
	}

	return BOOT_HOOK_REGULAR;
}

fih_int boot_image_check_hook(int img_index, int slot)
{
	if (img_index == 1) {
		FIH_RET(FIH_SUCCESS);
	}

	FIH_RET(fih_int_encode(BOOT_HOOK_REGULAR));
}

int boot_perform_update_hook(int img_index, struct image_header *img_head,
		const struct flash_area *area)
{
	return BOOT_HOOK_REGULAR;
}

int boot_read_swap_state_primary_slot_hook(int image_index,
		struct boot_swap_state *state)
{
	if (image_index == 1) {
		/* Populate with fake data */
		state->magic = BOOT_MAGIC_UNSET;
		state->swap_type = BOOT_SWAP_TYPE_NONE;
		state->image_num = image_index;
		state->copy_done = BOOT_FLAG_UNSET;
		state->image_ok = BOOT_FLAG_UNSET;

		/*
		 * Skip more handling of the primary slot for Image 1 as the slot
		 * exsists in RAM and is empty.
		 */
		return 0;
	}

	return BOOT_HOOK_REGULAR;
}


int boot_copy_region_post_hook(int img_index, const struct flash_area *area,
		size_t size)
{
	if (img_index == SECONDARY_SLOT_1) {
		return 0;
	}

	return 0;
}

int boot_serial_uploaded_hook(int img_index, const struct flash_area *area,
		size_t size)
{
	if (img_index == PRIMARY_SLOT_1) {
		return 0;
	}

	return 0;
}
```
