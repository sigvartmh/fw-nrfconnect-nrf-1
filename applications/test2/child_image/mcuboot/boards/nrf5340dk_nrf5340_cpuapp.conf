## applications/test2/child_image/mcuboot/boards/nrf5340dk_nrf5340_cpuapp.conf
```kconfig
#
# Copyright (c) 2021 Nordic Semiconductor ASA
#
# SPDX-License-Identifier: LicenseRef-Nordic-5-Clause
#


# The following configurations are required to support simultaneous multi image update
CONFIG_PCD_APP=y
CONFIG_UPDATEABLE_IMAGE_NUMBER=2
CONFIG_FLASH_SIMULATOR=y
CONFIG_FLASH_SIMULATOR_DOUBLE_WRITES=y
CONFIG_FLASH_SIMULATOR_STATS=n
CONFIG_BOOT_UPGRADE_ONLY=y
CONFIG_NRF53_RECOVERY_NETWORK_CORE=y
CONFIG_MCUBOOT_SERIAL_DIRECT_IMAGE_UPLOAD=y
CONFIG_MCUBOOT_SERIAL=y
CONFIG_BOOT_IMAGE_ACCESS_HOOKS=y

CONFIG_SIZE_OPTIMIZATIONS=y
```

## drivers/flash/Kconfig
```kconfig
#
# Copyright (c) 2024 Nordic Semiconductor
#
# SPDX-License-Identifier: LicenseRef-Nordic-5-Clause
#

config  FLASH_RPC
	bool "Flash over RPC [EXPERIMENTAL]"
	select NRF_RPC
	select NRF_RPC_CBOR
	help
	  Enables a seralized flash API of a device's flash over RPC

if FLASH_RPC

choice
	prompt "Flash RPC role selection"
	default FLASH_RPC_HOST if SOC_NRF5340_CPUNET
	default FLASH_RPC_CONTROLLER

config FLASH_RPC_CONTROLLER
	bool "Flash RPC Controller"
	help
	  Flash RPC API will use the nRF RPC library to access the flash of a host
	  on the remote core.

config FLASH_RPC_HOST
	bool "Flash RPC Host"
	help
	  Flash RPC API will expose the flash of a host to a client on the remote core.
endchoice

module = FLASH_RPC
module-str = Flash over nRF RPC
source "${ZEPHYR_BASE}/subsys/logging/Kconfig.template.log_config"

endif # FLASH_RPC
```

## ext/cjson/Kconfig
```kconfig
#
# Copyright (c) 2018 Nordic Semiconductor
#
# SPDX-License-Identifier: LicenseRef-BSD-5-Clause-Nordic
#

# Kconfig - cJSON Library for Zephyr

config  CJSON_LIB
	bool "cJSON library"
	# Since minimal libc lacks sscanf and strtod we need to use newlibc
	depends on NEWLIB_LIBC
	default n
	help
	  Enable the cJSON Library
```

## ext/uzlib/Kconfig
```kconfig
#
# Copyright (c) 2018 Nordic Semiconductor
#
# SPDX-License-Identifier: LicenseRef-BSD-5-Clause-Nordic
#

# Kconfig - cJSON Library for Zephyr

config  UZLIB_LIB
	bool "uzlib library"
	default n
	help
	  Enable the uzlib Library
```

## lib/libmodem/Kconfig
```kconfig
# Copyright (c) 2018 Nordic Semiconductor
#
# SPDX-License-Identifier: LicenseRef-BSD-5-Clause-Nordic
#

menuconfig LIBMODEM
	bool "Enable Modem library"
	imply NRFX_IPC
	imply NET_SOCKETS_OFFLOAD
	imply NET_SOCKETS_POSIX_NAMES
	select NRF_MODEM
	help
	  Use Nordic libmodem library.

if LIBMODEM

config LIBMODEM_SYS_INIT
	bool "Initialize during SYS_INIT"
	default y
	help
	  Initialize libmodem automatically during the SYS_INIT sequence.
	  Please note that libmodem initialization is synchronous and can
	  take up to one minute in case the modem firmware is updated.

config LIBMODEM_TRACE_ENABLED
	bool
	prompt "Enable proprietary traces over UART"
	# Modem tracing over UART use the UARTE1 as dedicated peripheral.
	# This enable UARTE1 peripheral and includes nrfx UARTE driver.
	select NRFX_UARTE1

config NRF91_SOCKET_SEND_SPLIT_LARGE_BLOCKS
	bool "Split large blocks passed to send() or sendto()"
	default n
	help
	  Workaround a limitation in the nRF91 modem firmware's libmodem
	  implementation regarding return value for send() or sendto()
	  calls larger than the module can handle. It should send the data
	  up to the maximum, and return that as the return value. Instead,
	  it returns error 22.

config NRF91_SOCKET_BLOCK_LIMIT
	int "Maximum size the modem can send"
	default 2048
	help
	  Blocks larger than this value will be split into two or more
	  send() or sendto() calls. This may not work for certain kinds
	  of sockets or certain flag parameter values.

config LIBMODEM_SENDMSG_BUF_SIZE
	int "Size of the sendmsg intermediate buffer"
	default 128
	help
	  Size of an intermediate buffer used by `sendmsg` to repack data and
	  therefore limit the number of `sendto` calls. The buffer is created
	  in a static memory, so it does not impact stack/heap usage. In case
	  the repacked message would not fit into the buffer, `sendmsg` sends
	  each message part separately.

endif # LIBMODEM
```

## samples/crypto/hmac/sample.yaml
```yaml
sample:
    description: This app provides an example of performing HMAC signing and 
        verification using the SHA256 hashing algorithm
        decryption using AES CBC mode
    name: HMAC example
tests:
    sample.hmac:
        tags: introduction
        platform_allow: nrf5340pdk_nrf5340_cpuappns nrf5340dk_nrf5340_cpuappns
        nrf9160dk_nrf9160ns
        harness: console
        harness_config:
          type: multi_line
          regex:
            - "*Example finished succesfully!*"
```

## samples/crypto/rsa/sample.yaml
```yaml
sample:
    description: This app provides an example of performing RSA signing and
        verification
    name: RSA example
tests:
    sample.rsa:
        tags: introduction
        platform_allow: nrf5340pdk_nrf5340_cpuappns nrf5340dk_nrf5340_cpuappns
        nrf9160dk_nrf9160ns
        harness: console
        harness_config:
          type: multi_line
          regex:
            - "*Example finished succesfully!*"
```

## samples/crypto/sha256/sample.yaml
```yaml
sample:
    description: This app provides an example of hashing using SHA256
    name: SHA256 example
tests:
    sample.sha256:
        tags: introduction
        platform_allow: nrf5340pdk_nrf5340_cpuappns nrf5340dk_nrf5340_cpuappns
        nrf9160dk_nrf9160ns
        harness: console
        harness_config:
          type: multi_line
          regex:
            - "*Example finished succesfully!*"
```

## subsys/dfu/Kconfig
```kconfig
#
# Copyright (c) 2019 Nordic Semiconductor ASA
#
# SPDX-License-Identifier: LicenseRef-BSD-5-Clause-Nordic
#

menuconfig DFU_TARGET
	bool "Device Firmware Update Handler"

if (DFU_TARGET)

config DFU_TARGET_MCUBOOT
	bool "MCUBoot Update support"
	default y if BOOTLOADER_MCUBOOT
	select FLASH
	select FLASH_PAGE_LAYOUT
	select IMG_MANAGER
	select MPU_ALLOW_FLASH_WRITE
	select IMG_ERASE_PROGRESSIVELY
	help
	  Support updates which are performed by MCUBoot.


config DFU_TARGET_MODEM
	bool "Modem Update support"
	default y if SOC_NRF9160_SICA
	help
	  Support updates to the modem firmware.

module=DFU_TARGET
module-dep=LOG
module-str=Device Firmware Upgrade
source "${ZEPHYR_BASE}/subsys/logging/Kconfig.template.log_config"

endif # DFU_TARGET
```

## subsys/dfu/mfu_ext/Kconfig
```kconfig
#
# Copyright (c) 2020 Nordic Semiconductor ASA
#
# SPDX-License-Identifier: LicenseRef-BSD-5-Clause-Nordic
#

menuconfig MFU_EXT
	bool "Modem Firmware Upgrade from external flash"

if (MFU_EXT)

module=MFU_EXT
module-dep=LOG
module-str=MFU EXT
source "${ZEPHYR_BASE}/subsys/logging/Kconfig.template.log_config"

endif #MFU_EXT
```

## subsys/net/lib/aws_fota/Kconfig
```kconfig
# Copyright (c) 2018 Nordic Semiconductor
#
# SPDX-License-Identifier: LicenseRef-BSD-5-Clause-Nordic
#

menuconfig AWS_JOBS_FOTA
	bool "AWS Jobs FOTA library"
	select AWS_JOBS
	select FOTA_DOWNLOAD
	select JSON_LIBRARY
	#we need to imply a value for heap as this library requiers a heap
	#for the JSON obj parse

if AWS_JOBS_FOTA

config VERSION_STRING_MAX_LEN
	int "Application version string max length"
	default 10

config AWS_IOT_JOBS_MESSAGE_SIZE
	int "MQTT message reception buffer size for AWS IoT Jobs messages"
	default 1350
config DEVICE_SHADOW_PAYLOAD_SIZE
	int "MQTT message reception buffer size for AWS IoT Jobs messages"
	default 256

module=AWS_JOBS_FOTA
module-dep=LOG
module-str=Log level for AWS Jobs FOTA
module-help=Enables AWS Jobs FOTA log messages.
source "${ZEPHYR_BASE}/subsys/logging/Kconfig.template.log_config"

endif # AWS_JOBS
```

## subsys/net/lib/aws_jobs/Kconfig
```kconfig
# Copyright (c) 2018 Nordic Semiconductor
#
# SPDX-License-Identifier: LicenseRef-BSD-5-Clause-Nordic
#

menuconfig AWS_JOBS
	bool "AWS Jobs library"

if AWS_JOBS

config CLIENT_ID_LEN
	int "MQTT Client ID length"
	default 19


module=AWS_JOBS
module-dep=LOG
module-str=Log level for AWS Jobs
module-help=Enables AWS Jobs log messages.
source "${ZEPHYR_BASE}/subsys/logging/Kconfig.template.log_config"

endif # AWS_JOBS
```

## subsys/net/lib/fota_download/Kconfig
```kconfig
#
# Copyright (c) 2019 Nordic Semiconductor ASA
#
# SPDX-License-Identifier: LicenseRef-BSD-5-Clause-Nordic
#

menuconfig FOTA_DOWNLOAD
	bool "FOTA Download"
	select DOWNLOAD_CLIENT
	select DFU_CTX

if (FOTA_DOWNLOAD)

module=FOTA_DOWNLOAD
module-dep=LOG
module-str=Firmware Over the Air Download
source "${ZEPHYR_BASE}/subsys/logging/Kconfig.template.log_config"

endif # FOTA_DOWNLOAD
```

## tests/subsys/dfu/mfu_ext/testcase.yaml
```yaml
tests:
  dfu.mfu_ext:
    platform_allow: native_posix
    tags: dfu mfu_ext
    # TODO add overlay for 9160 with DK
    # and add support for that as well
```

## tests/subsys/pcd/testcase.yaml
```yaml
tests:
  dfu.pcd:
    platform_whitelist: nrf5340dk_nrf5340_cpuapp
    tags: pcd
```
