## CMakeLists.txt
```
#
# Copyright (c) 2026 Nordic Semiconductor ASA
#
# SPDX-License-Identifier: LicenseRef-Nordic-5-Clause
#

cmake_minimum_required(VERSION 3.20.0)

find_package(Zephyr REQUIRED HINTS $ENV{ZEPHYR_BASE})
project(reproducer_replay)

target_sources(app PRIVATE src/main.c src/replay_data.c)
target_include_directories(app PRIVATE src)
```

## prj.conf
```kconfig
#
# Copyright (c) 2026 Nordic Semiconductor ASA
#
# SPDX-License-Identifier: LicenseRef-Nordic-5-Clause
#

CONFIG_LOG=y
CONFIG_PRINTK=y
# Immediate mode so the last log line before a hang is not lost
CONFIG_LOG_MODE_IMMEDIATE=y

# Match the failing psa_tls build
CONFIG_MAIN_STACK_SIZE=8192
CONFIG_SPEED_OPTIMIZATIONS=y

# PSA crypto through the IronSide SE / SSF client, as in psa_tls on nrf54h20.
# The replay bypasses the PSA API and issues psa_call directly, but the SSF
# client (psa_call implementation and bounce buffers) must be in the build.
CONFIG_PSA_CRYPTO=y
CONFIG_PSA_SSF_CRYPTO_CLIENT=y
CONFIG_PSA_CRYPTO_DRIVER_OBERON=n
CONFIG_PSA_WANT_ALG_SHA_256=y
CONFIG_PSA_WANT_ALG_SHA_384=y
```

## src/main.c
```c
/*
 * Copyright (c) 2026 Nordic Semiconductor ASA
 *
 * SPDX-License-Identifier: LicenseRef-Nordic-5-Clause
 */

/*
 * Replays the exact psa_call request stream captured from the psa_tls
 * TLS 1.3 client run that hangs on nrf54h20dk/nrf54h20/cpuapp
 * (IronSide SE never responds to a SHA transcript-hash finish).
 *
 * The stream (replay_data.c, generated by gen_replay.py from the
 * instrumented psa_tls trace) is issued through psa_call() directly,
 * back to back with no logging in the loop, using the original buffer
 * addresses, lengths and input contents. Input bytes beyond the
 * captured 64-byte prefix are filled with 0x5a; calls whose semantics
 * depend on that content (AEAD decrypt, signature verify) return
 * errors instead of success, which is recorded but does not stop the
 * replay.
 *
 * Probe-readable progress (survives a hang; read while the core runs):
 *   replay_pass     - current pass (1-based)
 *   replay_idx      - index into replay_calls of the call in flight
 *   replay_mismatch - number of calls whose status differed from the
 *                     recorded one
 */

#include <stddef.h>
#include <stdint.h>
#include <string.h>
#include <zephyr/kernel.h>
#include <zephyr/logging/log.h>

#include "replay.h"

LOG_MODULE_REGISTER(repro_replay, LOG_LEVEL_INF);

#define NUM_PASSES 200

/* ABI-compatible with psa_invec/psa_outvec from psa/client.h. */
struct call_iovec {
	const void *base;
	size_t len;
};

int32_t psa_call(int32_t handle, int32_t type, const struct call_iovec *in_vec, size_t in_len,
		 struct call_iovec *out_vec, size_t out_len);

volatile uint32_t replay_pass;
volatile uint32_t replay_idx;
volatile uint32_t replay_mismatch;

extern char _image_ram_end[];

/* Buffers whose original address falls inside this application's own
 * image RAM are staged here instead (offset-preserving).
 */
static uint8_t shadow[256];

static void *target_addr(uint32_t addr)
{
	if (addr < replay_remap_below) {
		return &shadow[addr - replay_low_base];
	}
	return (void *)addr;
}

int main(void)
{
	LOG_INF("psa_call replay reproducer: %u calls, targets 0x%08x..0x%08x",
		replay_num_calls, replay_min_addr, replay_max_addr);

	if (replay_low_size > sizeof(shadow)) {
		LOG_ERR("shadow buffer too small: need %u", replay_low_size);
		return 0;
	}

	if ((uintptr_t)_image_ram_end > replay_guard_addr) {
		LOG_ERR("image RAM end %p overlaps replay target range - aborting",
			(void *)_image_ram_end);
		return 0;
	}

	for (replay_pass = 1; replay_pass <= NUM_PASSES; replay_pass++) {
		for (replay_idx = 0; replay_idx < replay_num_calls; replay_idx++) {
			const struct replay_call *c = &replay_calls[replay_idx];
			struct call_iovec in_vec[REPLAY_MAX_VEC];
			struct call_iovec out_vec[REPLAY_MAX_VEC];
			int32_t st;

			for (int i = 0; i < c->n_in; i++) {
				uint8_t *dst = target_addr(c->iv[i].addr);

				memcpy(dst, &replay_blob[c->iv[i].blob_off], c->iv[i].dlen);
				if (c->iv[i].len > c->iv[i].dlen) {
					memset(dst + c->iv[i].dlen, 0x5a,
					       c->iv[i].len - c->iv[i].dlen);
				}
				in_vec[i].base = dst;
				in_vec[i].len = c->iv[i].len;
			}

			for (int i = 0; i < c->n_out; i++) {
				out_vec[i].base = target_addr(c->ov[i].addr);
				out_vec[i].len = c->ov[i].len;
			}

			st = psa_call(c->handle, c->type, in_vec, c->n_in, out_vec, c->n_out);

			if (st != c->expected_st) {
				replay_mismatch++;
			}
		}

		if (replay_pass % 10 == 0) {
			LOG_INF("pass %u done, %u status mismatches total", replay_pass,
				replay_mismatch);
		}
	}

	LOG_INF("All passes completed - no hang (%u status mismatches)", replay_mismatch);
	return 0;
}
```

## src/replay.h
```c
/*
 * Copyright (c) 2026 Nordic Semiconductor ASA
 *
 * SPDX-License-Identifier: LicenseRef-Nordic-5-Clause
 */

#ifndef REPLAY_H_
#define REPLAY_H_

#include <stdint.h>

#define REPLAY_MAX_VEC 4

struct replay_iv {
	uint32_t addr;     /* original buffer address to stage data at */
	uint32_t len;      /* original in_vec length */
	uint32_t blob_off; /* offset of captured content in replay_blob */
	uint32_t dlen;     /* captured content length (<= len) */
};

struct replay_ov {
	uint32_t addr; /* original output buffer address */
	uint32_t len;  /* original out_vec length */
};

struct replay_call {
	uint16_t seq;
	uint32_t handle;
	int32_t type;
	int32_t expected_st;
	uint8_t n_in;
	uint8_t n_out;
	struct replay_iv iv[REPLAY_MAX_VEC];
	struct replay_ov ov[REPLAY_MAX_VEC];
};

extern const uint8_t replay_blob[];
extern const struct replay_call replay_calls[];
extern const uint32_t replay_num_calls;
extern const uint32_t replay_min_addr;
extern const uint32_t replay_max_addr;
extern const uint32_t replay_remap_below;
extern const uint32_t replay_low_base;
extern const uint32_t replay_low_size;
extern const uint32_t replay_guard_addr;

#endif /* REPLAY_H_ */
```
