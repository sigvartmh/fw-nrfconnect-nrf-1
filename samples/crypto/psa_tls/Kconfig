## samples/crypto/psa_tls/Kconfig
```kconfig
#
# Copyright (c) 2021 Nordic Semiconductor
#
# SPDX-License-Identifier: LicenseRef-Nordic-5-Clause
#

source "Kconfig.zephyr"

menu "PSA TLS sample"

choice SAMPLE_PSA_TLS_CERTIFICATE_TYPE
	prompt "Certificate type"
	default SAMPLE_PSA_TLS_CERTIFICATE_TYPE_ECDSA
	help
	  Select the certificate type to use in the PSA TLS sample.

config SAMPLE_PSA_TLS_CERTIFICATE_TYPE_RSA
	bool "RSA certificate for the PSA TLS sample"
	help
	  Enable RSA certificates when testing ciphers that supports RSA for authentication.

config SAMPLE_PSA_TLS_CERTIFICATE_TYPE_ECDSA
	bool "ECDSA certificate for the PSA TLS sample"
	help
	  Enable ECDSA certificates when testing ciphers that supports ECDSA for authentication.

endchoice

choice SAMPLE_PSA_TLS_TYPE
	prompt "Server or client selection"
	default SAMPLE_PSA_TLS_TYPE_SERVER

config SAMPLE_PSA_TLS_TYPE_SERVER
	bool "Server functionality for the PSA TLS sample"
	help
	  When acting as a server, the sample waits for a connection from the client on port 4243.
	  After the TCP connection is established, the sample waits for the "ClientHello" message
	  from the client.

config SAMPLE_PSA_TLS_TYPE_CLIENT
	bool "Client functionality for the PSA TLS sample"
	help
	  When acting as a client, the sample tries to connect to the server on port 4243.
	  After the TCP connection is established, the sample automatically initiates the TLS handshake
	  by sending the "ClientHello" message.

endchoice

config SAMPLE_PSA_CALL_TRACE
	bool "Trace psa_call requests over the console"
	help
	  Wraps psa_call with debug instrumentation that prints every
	  request (handle, type, io vector addresses, lengths and input
	  data) before it is dispatched to the crypto service, and its
	  status when it returns. Used to record the exact PSA call
	  stream for debugging.

config SAMPLE_PSA_CALL_TRACE_NULL
	bool "Wrap psa_call with an empty passthrough"
	help
	  Debug bisection aid: wraps psa_call with a passthrough that
	  compiles to a tail branch, isolating the pure text-layout
	  effect of the tracing wrappers.

config SAMPLE_PSA_DATA_PAD
	bool "Insert a 32 KiB pad at the front of .data"
	help
	  Debug bisection aid: displaces .data/.bss by the same amount
	  as the RAM ring tracer, without wrapping psa_call.

config SAMPLE_PSA_CALL_PERTURB
	int "Wrap psa_call with an isolated runtime perturbation"
	default 0
	help
	  Debug bisection aid; see src/psa_call_perturb.c. 0 disables,
	  1 = busy loop, 2 = static-buffer stores, 3 = timer read.

config SAMPLE_PSA_CALL_TRACE_RAM
	bool "Trace psa_call requests into a RAM ring buffer"
	depends on !SAMPLE_PSA_CALL_TRACE
	help
	  Wraps psa_call with low-overhead debug instrumentation that
	  records every request into a RAM ring buffer
	  (psa_call_trace_ring), leaving the call timing essentially
	  unperturbed. Intended for capturing the call stream of a run
	  that hangs; dump the ring over the debug probe afterwards. A
	  record whose status is 0x7fffffff marks a call that never
	  returned.

endmenu
```
