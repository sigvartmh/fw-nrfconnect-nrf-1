## CMakeLists.txt
```
#
# Copyright (c) 2021 Nordic Semiconductor ASA
#
# SPDX-License-Identifier: LicenseRef-Nordic-5-Clause
#

cmake_minimum_required(VERSION 3.13.1)

# Override the binary used by qemu
set(QEMU_KERNEL_OPTION "-device;loader,file=${CMAKE_BINARY_DIR}/tfm_qemu.hex")

find_package(Zephyr REQUIRED HINTS $ENV{ZEPHYR_BASE})

project(aes_cbc)

target_sources(app PRIVATE
        src/main.c)
```

## sample.yaml
```
sample:
    description: This app provides an example of performing AES encryption and
        decryption using AES CBC mode
    name: AES CBC example
tests:
    sample.aes_cbc:
        tags: introduction
        platform_allow: nrf5340pdk_nrf5340_cpuappns nrf5340dk_nrf5340_cpuappns
        nrf9160dk_nrf9160ns
        harness: console
        harness_config:
          type: multi_line
          regex:
            - "*Example finished succesfully!*"
```

## prj.conf
```kconfig
CONFIG_BUILD_WITH_TFM=y

# The Zephyr CMSIS emulation assumes that ticks are ms, currently
CONFIG_SYS_CLOCK_TICKS_PER_SEC=1000

CONFIG_MAIN_STACK_SIZE=4096
CONFIG_HEAP_MEM_POOL_SIZE=4096

# Enable loging using RTT and UART
CONFIG_CONSOLE=y
CONFIG_LOG=y
CONFIG_USE_SEGGER_RTT=y
CONFIG_LOG_BACKEND_RTT=y
CONFIG_LOG_BACKEND_UART=y
CONFIG_LOG_BUFFER_SIZE=1536
CONFIG_SEGGER_RTT_BUFFER_SIZE_UP=15360

CONFIG_TFM_PARTITION_AUDIT_LOG=n
CONFIG_MBEDTLS_RSA_C=n
CONFIG_TFM_BL2=n
CONFIG_PM_PARTITION_SIZE_BL2=0x0
```

## src/main.c
```c
/*
 * Copyright (c) 2021 Nordic Semiconductor ASA
 *
 * SPDX-License-Identifier: LicenseRef-Nordic-5-Clause
 */

#include <zephyr.h>
#include <sys/printk.h>
#include <logging/log.h>
#include <stdio.h>

#include <psa/crypto.h>
#include <psa/crypto_extra.h>
#include <tfm_ns_interface.h>

LOG_MODULE_REGISTER(aes_cbc, LOG_LEVEL_DBG);

K_MUTEX_DEFINE(tfm_mutex);

#define PSA_ERROR_CHECK(func, status)\
	({\
		if (status != PSA_SUCCESS) {\
			LOG_INF("+++ Function %s failed with error code: %d\r\n",\
			       func, status);\
			return -1;\
		}\
	})

void print_message(char const *p_text){
	LOG_INF("%s", p_text);
}

void print_hex(char const *p_label, char const *p_text, size_t len)
{
	LOG_INF("---- %s (len: %u): ----", p_label, len);
	LOG_HEXDUMP_INF(p_text, len, "Content:");
	LOG_INF("---- %s end  ----", p_label);
}

/* ====================================================================== */
/* Global variables/defines for the AES-CBC-NO-PADDING example */

#define NRF_CRYPTO_EXAMPLE_AES_MAX_TEXT_SIZE (64)
#define NRF_CRYPTO_EXAMPLE_AES_BLOCK_SIZE (16)

/* AES sample key, DO NOT USE IN PRODUCTION */
static uint8_t m_key[NRF_CRYPTO_EXAMPLE_AES_BLOCK_SIZE] = {
	'A', 'E', 'S', ' ', 'C', 'B', 'C', ' ',
	'K', 'E', 'Y', ' ', 'T', 'E', 'S', 'T'
};

static uint8_t m_iv[NRF_CRYPTO_EXAMPLE_AES_BLOCK_SIZE];

/* Below text is used as plaintext for encryption/decryption */
static uint8_t m_plain_text[NRF_CRYPTO_EXAMPLE_AES_MAX_TEXT_SIZE] = {
	"Example string to demonstrate basic usage of AES CBC mode."
};

static uint8_t m_encrypted_text[NRF_CRYPTO_EXAMPLE_AES_MAX_TEXT_SIZE];
static uint8_t m_decrypted_text[NRF_CRYPTO_EXAMPLE_AES_MAX_TEXT_SIZE];

/* ====================================================================== */



int decrypt_cbc_aes()
{
	uint32_t output_len;
	psa_status_t status;

	/* Crypto settings for AES-CBC decryption using an AES-128 bit key */
	psa_algorithm_t alg = PSA_ALG_CBC_NO_PADDING;
	psa_key_type_t key_type = PSA_KEY_TYPE_AES;
	psa_key_usage_t key_usage = PSA_KEY_USAGE_DECRYPT;
	psa_key_lifetime_t key_lifetime = PSA_KEY_LIFETIME_VOLATILE;
	psa_key_handle_t key_handle;
	psa_key_attributes_t key_attributes = PSA_KEY_ATTRIBUTES_INIT;
	psa_cipher_operation_t operation = PSA_CIPHER_OPERATION_INIT;

	print_message("Decrypting using AES CBC MODE...");

	/* Initialize PSA Crypto */
	status = psa_crypto_init();
	PSA_ERROR_CHECK("psa_crypto_init", status);

	/* Configure the key attributes */
	psa_set_key_usage_flags(&key_attributes, key_usage);
	psa_set_key_lifetime(&key_attributes, key_lifetime);
	psa_set_key_algorithm(&key_attributes, alg);
	psa_set_key_type(&key_attributes, key_type);
	psa_set_key_bits(&key_attributes, 128);

	/* Import the key to the keystore */
	status = psa_import_key(&key_attributes, m_key, sizeof(m_key),
				&key_handle);
	PSA_ERROR_CHECK("psa_import_key", status);

	/* After the key handle is acquired the attributes are not needed */
	psa_reset_key_attributes(&key_attributes);

	/* Setup the decryption operation */
	status = psa_cipher_decrypt_setup(&operation, key_handle, alg);
	PSA_ERROR_CHECK("psa_cipher_decrypt_setup", status);

	/* Set the IV generated in encryption */
	status = psa_cipher_set_iv(&operation, m_iv, sizeof(m_iv));
	PSA_ERROR_CHECK("psa_cipher_set_iv", status);

	/* Perform the decryption */
	status = psa_cipher_update(&operation, m_encrypted_text,
				   sizeof(m_encrypted_text), m_decrypted_text,
				   sizeof(m_decrypted_text), &output_len);
	PSA_ERROR_CHECK("psa_cipher_update", status);

	/* Finalize the decryption */
	status = psa_cipher_finish(&operation, m_decrypted_text + output_len,
				   sizeof(m_decrypted_text) - output_len,
				   &output_len);
	PSA_ERROR_CHECK("psa_cipher_finish", status);

	print_hex("Decrypted text", m_decrypted_text, sizeof(m_decrypted_text));

	/* Check the validity of the decryption */
	if ( memcmp(m_decrypted_text,
						m_plain_text,
						NRF_CRYPTO_EXAMPLE_AES_MAX_TEXT_SIZE) !=0 ){
			print_message("Error: Decrypted text doesn't match the plaintext");
			return -1;
	}

	print_message("Decryption succesfull!");

	/*  Clean up cipher operation context */
	psa_cipher_abort(&operation);

	/* Destroy the key */
	psa_destroy_key(key_handle);

	return 1;
}

int encrypt_cbc_aes()
{
	uint32_t output_len;
	psa_status_t status;

	/* Crypto settings for AES-CBC decryption using an AES-128 bit key */
	psa_algorithm_t alg = PSA_ALG_CBC_NO_PADDING;
	psa_key_type_t key_type = PSA_KEY_TYPE_AES;
	psa_key_usage_t key_usage = PSA_KEY_USAGE_ENCRYPT;
	psa_key_lifetime_t key_lifetime = PSA_KEY_LIFETIME_VOLATILE;
	psa_key_handle_t key_handle;
	psa_key_attributes_t key_attributes = PSA_KEY_ATTRIBUTES_INIT;
	psa_cipher_operation_t operation = PSA_CIPHER_OPERATION_INIT;

	print_message("Encrypting using AES CBC MODE...");

	/* Initialize PSA Crypto */
	status = psa_crypto_init();
	PSA_ERROR_CHECK("psa_crypto_init", status);

	/* Configure the key attributes */
	psa_set_key_usage_flags(&key_attributes, key_usage);
	psa_set_key_lifetime(&key_attributes, key_lifetime);
	psa_set_key_algorithm(&key_attributes, alg);
	psa_set_key_type(&key_attributes, key_type);
	psa_set_key_bits(&key_attributes, 128);

	/* Import the key to the keystore */
	status = psa_import_key(&key_attributes, m_key, sizeof(m_key),
				&key_handle);
	PSA_ERROR_CHECK("psa_import_key", status);

	/* After the key handle is acquired the attributes are not needed */
	psa_reset_key_attributes(&key_attributes);

	/* Setup the encryption operation */
	status = psa_cipher_encrypt_setup(&operation, key_handle, alg);
	PSA_ERROR_CHECK("psa_cipher_encrypt_setup", status);

	/* Generate an IV */
	status = psa_cipher_generate_iv(&operation, m_iv, sizeof(m_iv),
					&output_len);
	PSA_ERROR_CHECK("psa_cipher_generate_iv", status);

	/* Perform the encryption */
	status = psa_cipher_update(&operation, m_plain_text,
				   sizeof(m_plain_text), m_encrypted_text,
				   sizeof(m_encrypted_text), &output_len);
	PSA_ERROR_CHECK("psa_cipher_update", status);

	/* Finalize the encryption */
	status = psa_cipher_finish(&operation, m_encrypted_text + output_len,
				   sizeof(m_encrypted_text) - output_len,
				   &output_len);
	PSA_ERROR_CHECK("psa_cipher_finish", status);

	print_message("Encryption succesfull!");
	print_hex("Key", m_key, sizeof(m_key));
	print_hex("IV", m_iv, sizeof(m_iv));
	print_hex("Plaintext", m_plain_text, sizeof(m_plain_text));
	print_hex("Encrypted text", m_encrypted_text, sizeof(m_encrypted_text));

	/* Clean up cipher operation context */
	psa_cipher_abort(&operation);

	/* Destroy the key */
	psa_destroy_key(key_handle);

	return 1;
}

void main(void)
{
	enum tfm_status_e tfm_status;

	print_message("Starting AES-CBC-NO-PADDING example...");

	tfm_status = tfm_ns_interface_init();
	if (tfm_status != TFM_SUCCESS) {
		print_message("TFM initialization failed!");
		return;
	}

	if (encrypt_cbc_aes() > 0) {
		if (decrypt_cbc_aes() > 0) {
			print_message("Example finished succesfully!");
			return;
		}
	}

	print_message("Example exited with error!");
}
```
