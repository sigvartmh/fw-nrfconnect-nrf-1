## prj.conf
```kconfig
#
# Copyright (c) 2021 Nordic Semiconductor ASA
#
# SPDX-License-Identifier: LicenseRef-Nordic-5-Clause
#

CONFIG_LOG=y
CONFIG_LOG_BACKEND_RTT=y
CONFIG_LOG_BACKEND_UART=n
CONFIG_UART_CONSOLE=n
CONFIG_USE_SEGGER_RTT=y
CONFIG_RTT_CONSOLE=y

# Enable FPU
CONFIG_FPU=y

# Enable mcumgr.
CONFIG_MCUMGR=y

# Some command handlers require a large stack.
CONFIG_SYSTEM_WORKQUEUE_STACK_SIZE=4096

# Enable the UART mcumgr transports.
CONFIG_MCUMGR_SMP_UART=y
CONFIG_UART_MCUMGR_RX_BUF_SIZE=512
CONFIG_MCUMGR_BUF_SIZE=512

# Required by the `taskstat` command.
CONFIG_THREAD_MONITOR=y

# Enable statistics and statistic names.
CONFIG_STATS=y
CONFIG_STATS_NAMES=y

# Enable STAT and OS from the core commands
CONFIG_MGMT_FMFU=y
CONFIG_MCUMGR_CMD_OS_MGMT=y
CONFIG_MCUMGR_CMD_STAT_MGMT=y
CONFIG_MCUMGR_CMD_IMG_MGMT=y

CONFIG_NRF_MODEM_LIB=y
CONFIG_NRF_MODEM_LIB_SYS_INIT=n

# Used for getting the modem version
CONFIG_AT_CMD=y
CONFIG_AT_CMD_SYS_INIT=n
CONFIG_AT_CMD_PARSER=y
CONFIG_MODEM_INFO=y
CONFIG_NEWLIB_LIBC=y

CONFIG_NETWORKING=y
CONFIG_NET_SOCKETS=y
CONFIG_NET_SOCKETS_OFFLOAD=y
CONFIG_HEAP_MEM_POOL_SIZE=8192

# Enable MCUBOOT
CONFIG_MCUMGR_CMD_IMG_MGMT=y
CONFIG_MCUMGR_CMD_OS_MGMT=y
CONFIG_MCUMGR_CMD_STAT_MGMT=y

# Ensure an MCUboot-compatible binary is generated.
CONFIG_BOOTLOADER_MCUBOOT=y
```

## src/main.c
```c
/*
 * Copyright (c) 2021 Nordic Semiconductor ASA
 *
 * SPDX-License-Identifier: LicenseRef-Nordic-5-Clause
 */

#include <zephyr.h>
#include <mgmt/fmfu_mgmt.h>
#include <mgmt/fmfu_mgmt_stat.h>
#include <nrf_modem_full_dfu.h>
#include <modem/modem_info.h>
#include <modem/nrf_modem_lib.h>
#include <modem/at_cmd.h>
#include <dfu/mcuboot.h>
#ifdef CONFIG_MCUMGR_CMD_IMG_MGMT
#include "img_mgmt/img_mgmt.h"
#endif
#ifdef CONFIG_MCUMGR_CMD_OS_MGMT
#include "os_mgmt/os_mgmt.h"
#endif

static void fmfu_callback_handler(enum fmfu_evt_id id)
{
	switch (id) {
	case FMFU_EVT_PRE_DFU_MODE:
		printk("Going to put the modem into DFU mode\n\r");
		break;
	case FMFU_EVT_FINISHED:
		printk("Modem update finished the device needs to be reset "
		       "for the update to be applied.\n\r");
		break;
	default:
		break;
	}

}

void main(void)
{
	int err = nrf_modem_lib_init(NORMAL_MODE);

	if (err == 0) {
		char modem_version[MODEM_INFO_MAX_RESPONSE_SIZE];

		err = at_cmd_init();
		if (err != 0) {
			printk("AT CMD Init error: %d\n\r", err);
		} else {
			err = modem_info_init();
			if (err != 0) {
				printk("Modem info Init error: %d\n\r", err);
			} else {
				modem_info_string_get(MODEM_INFO_FW_VERSION,
						modem_version,
						MODEM_INFO_MAX_RESPONSE_SIZE);
				printk("Starting modem mgmt sample\n\r");
				printk("Modem version: %s\n\r", modem_version);
			}
		}

	}
	/* Register SMP Communication stats */
	fmfu_mgmt_stat_init();
#ifdef CONFIG_MCUMGR_CMD_OS_MGMT
	os_mgmt_register_group();
#endif
#ifdef CONFIG_MCUMGR_CMD_IMG_MGMT
	img_mgmt_register_group();
#endif
	/* Initialize MCUMgr handlers for full modem update */
	err = fmfu_mgmt_register_group(fmfu_callback_handler);
	if (err) {
		printk("Error in fmfu init: %d\n\r", err);
	}
	printk("Initialized and ready to receive firmware\n\r");
	if (boot_is_img_confirmed()) {
		printk("Current image confirmed\n\r");
	} else {
		printk("Current image not confirmed yet\n\r");
	}
}
```
