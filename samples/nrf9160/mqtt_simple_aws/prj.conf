## CMakeLists.txt
```
#
# Copyright (c) 2018 Nordic Semiconductor
#
# SPDX-License-Identifier: LicenseRef-BSD-5-Clause-Nordic
#

cmake_minimum_required(VERSION 3.8.2)

include(../../../cmake/boilerplate.cmake NO_POLICY_SCOPE)
include($ENV{ZEPHYR_BASE}/cmake/app/boilerplate.cmake NO_POLICY_SCOPE)
project(mqtt-aws-jobs-fota)

# NORDIC SDK APP START
target_sources(app PRIVATE
	src/main.c
	src/dfu_thread.c
	)

target_include_directories(app PRIVATE src)
# NORDIC SDK APP END
```

## Kconfig
```
#
# Copyright (c) 2019 Nordic Semiconductor ASA
#
# SPDX-License-Identifier: LicenseRef-BSD-5-Clause-Nordic
#

menu "mqtt fota"

config DOWNLOAD_HOST
	string "Download host name"

config DOWNLOAD_FILE
	string "The file to download"

config MQTT_PUB_TOPIC
	string "MQTT publish topic"
	default "my/publish/topic"

config MQTT_SUB_TOPIC
	string "MQTT subscribe topic"
	default "my/subscribe/topic"

config MQTT_CLIENT_ID
	string "MQTT Client ID"
	default "my-client-id"

config MQTT_BROKER_HOSTNAME
	string "MQTT broker hostname"
	default "iot.eclipse.org"

config MQTT_BROKER_PORT
	int "MQTT broker port"
	default 1883

config MQTT_MESSAGE_BUFFER_SIZE
	int ""
	default 128

config MQTT_PAYLOAD_BUFFER_SIZE
	int ""
	default 128

endmenu

menu "Zephyr Kernel"
source "$ZEPHYR_BASE/Kconfig.zephyr"
endmenu
```

## prj.conf
```kconfig
# General config
CONFIG_TEST_RANDOM_GENERATOR=y
CONFIG_MPU_STACK_GUARD=y

CONFIG_IMG_MANAGER=y
CONFIG_BOOTLOADER_MCUBOOT=y

# Enable DOWNLOAD libs
CONFIG_NRF_DOWNLOAD_CLIENT=y
CONFIG_NRF_DOWNLOAD_MAX_RESPONSE_SIZE=2048

# Networking
CONFIG_NETWORKING=y
CONFIG_NET_SOCKETS_OFFLOAD=y
CONFIG_NET_SOCKETS_SOCKOPT_TLS=y
CONFIG_NET_SOCKETS=y
CONFIG_NET_SOCKETS_POSIX_NAMES=y

# LTE link control
CONFIG_LTE_LINK_CONTROL=y
CONFIG_LTE_AUTO_INIT_AND_CONNECT=n

# BSD library
CONFIG_BSD_LIBRARY=y

# AT Host
CONFIG_UART_INTERRUPT_DRIVEN=y
CONFIG_AT_HOST_LIBRARY=y

# MQTT
CONFIG_MQTT_LIB=y
CONFIG_MQTT_LIB_TLS=y

# Appliaction
#CONFIG_MQTT_PUB_TOPIC="/my/publish/topic"
#CONFIG_MQTT_SUB_TOPIC="/my/subscribe/topic"
#CONFIG_MQTT_CLIENT_ID="my-client-id"
#CONFIG_MQTT_BROKER_HOSTNAME="iot.eclipse.org"
#CONFIG_MQTT_BROKER_PORT=1883

# Main thread
CONFIG_MAIN_THREAD_PRIORITY=7
CONFIG_MAIN_STACK_SIZE=4096

CONFIG_HEAP_MEM_POOL_SIZE=4096
CONFIG_FLOAT=y
CONFIG_MQTT_MAX_PACKET_LENGTH=2048
#CONFIG_MBEDTLS_HEAP_SIZE=30000
CONFIG_MBEDTLS_SSL_MAX_CONTENT_LEN=2048
```

## src/main.c
```c
/*
 * Copyright (c) 2018 Nordic Semiconductor ASA
 *
 * SPDX-License-Identifier: LicenseRef-BSD-5-Clause-Nordic
 */

#include <zephyr.h>
#include <stdio.h>
#include <uart.h>
#include <string.h>

#include <net/mqtt.h>
#include <net/socket.h>
#include <lte_lc.h>
#include <cJSON.h>

#if defined(CONFIG_BSD_LIBRARY)
#include "nrf_inbuilt_key.h"
#endif

#define CONFIG_NRF_CLOUD_SEC_TAG 16842753
#define CONFIG_AWS_HOSTNAME "a25jld2wxwm7qs-ats.iot.eu-central-1.amazonaws.com"

//#include "aws_cert/rootca_rsa2048.h"
#include "aws_cert/rootca_ec.h"
#include "aws_cert/private_key.h"
#include "aws_cert/pubcert.h"

#if !defined(CONFIG_CLIENT_ID)
#define IMEI_LEN 15
#define CLIENT_ID_LEN (IMEI_LEN + 4)
#else
#define CLIENT_ID_LEN (sizeof(CLOUD_CLIENT_ID) - 1)
#endif
static u8_t client_id_buf[CLIENT_ID_LEN+1];

/* Buffers for MQTT client. */
static u8_t rx_buffer[CONFIG_MQTT_MESSAGE_BUFFER_SIZE];
static u8_t tx_buffer[CONFIG_MQTT_MESSAGE_BUFFER_SIZE];
static u8_t payload_buf[CONFIG_MQTT_PAYLOAD_BUFFER_SIZE];

/* MQTT Broker details. */
static struct sockaddr_storage broker;

/* File descriptor */
static struct pollfd fds;


#if defined(CONFIG_BSD_LIBRARY)

/**@brief Recoverable BSD library error. */
void bsd_recoverable_error_handler(uint32_t err)
{
	printk("bsdlib recoverable error: %u\n", err);
}

/**@brief Irrecoverable BSD library error. */
void bsd_irrecoverable_error_handler(uint32_t err)
{
	printk("bsdlib irrecoverable error: %u\n", err);

	__ASSERT_NO_MSG(false);
}

#endif /* defined(CONFIG_BSD_LIBRARY) */

/**@brief Function to print strings without null-termination
*/
static void data_print(u8_t *prefix, u8_t *data, size_t len)
{
	char buf[len + 1];

	memcpy(buf, data, len);
	buf[len] = 0;
	printk("%s%s\n", prefix, buf);
}

/**@brief Function to publish data on the configured topic
*/
static int data_publish(struct mqtt_client *c, enum mqtt_qos qos,
			u8_t *data, size_t len)
{
	struct mqtt_publish_param param;

	param.message.topic.qos = qos;
	param.message.topic.topic.utf8 = CONFIG_MQTT_PUB_TOPIC;
	param.message.topic.topic.size = strlen(CONFIG_MQTT_PUB_TOPIC);
	param.message.payload.data = data;
	param.message.payload.len = len;
	param.message_id = sys_rand32_get();
	param.dup_flag = 0;
	param.retain_flag = 0;

	data_print("publishing: ", data, len);
	return mqtt_publish(c, &param);
}



/**@brief Function to read the published payload.
*/
static int publish_get_payload(struct mqtt_client *c, size_t length)
{
	u8_t *buf = payload_buf;
	u8_t *end = buf + length;

	if (length > sizeof(payload_buf)) {
		return -EMSGSIZE;
	}

	while (buf < end) {
		int ret = mqtt_read_publish_payload(c, buf, end - buf);

		if (ret < 0) {
			int err;

			if (ret != -EAGAIN) {
				return ret;
			}
			printk("mqtt_read_publish_payload: EAGAIN\n");

			err = poll(&fds, 1, K_SECONDS(CONFIG_MQTT_KEEPALIVE));
			if (err > 0 && (fds.revents & POLLIN) == POLLIN) {
				continue;
			} else {
				return -EIO;
			}
		}

		if (ret == 0) {
			return -EIO;
		}

		buf += ret;
	}

	return 0;
}

extern void dfu_start_thread(const char * hostname, const char * resource_path);

/**@brief MQTT client event handler
*/
void mqtt_evt_handler(struct mqtt_client * const c,
		      const struct mqtt_evt *evt)
{
	int err;

	switch (evt->type) {
	case MQTT_EVT_CONNACK:
		if (evt->result != 0) {
			printk("MQTT connect failed %d\n", evt->result);
			break;
		}

		printk("[%s:%d] MQTT client connected!\n", __func__, __LINE__);
		err = aws_jobs_init(c);
		//aws_jobs_connected(true);
		if(err){
			printk("Unable to initialize AWS jobs upon connection\n");
			err = mqtt_disconnect(c);
			if (err) {
				printk("Could not disconnect: %d\n", err);
			}
		}
		break;

	case MQTT_EVT_DISCONNECT:
		printk("[%s:%d] MQTT client disconnected %d\n", __func__,
		       __LINE__, evt->result);
		break;

	case MQTT_EVT_PUBLISH: {
		const struct mqtt_publish_param *p = &evt->param.publish;

		printk("[%s:%d] MQTT PUBLISH result=%d len=%d\n", __func__,
		       __LINE__, evt->result, p->message.payload.len);
		err = publish_get_payload(c, p->message.payload.len);
		if (err >= 0) {
			/*
			aws_jobs_handler(c,
					 p->message.topic.topic.utf8,
					 payload_buf);
					 */
			/*
			data_print("Received: ", payload_buf,
				   p->message.payload.len);
			*/
			printk("Received on topic: %s\n", p->message.topic.topic.utf8);
		} else {
			printk("mqtt_read_publish_payload: Failed! %d\n", err);
			printk("Disconnecting MQTT client...\n");

			err = mqtt_disconnect(c);
			if (err) {
				printk("Could not disconnect: %d\n", err);
			}
		}

		if (p->message.topic.qos == MQTT_QOS_1_AT_LEAST_ONCE) {
			const struct mqtt_puback_param ack = {
				.message_id = p->message_id
			};

			/* Send acknowledgment. */
			err = mqtt_publish_qos1_ack(c, &ack);
			if(err) {
				printk("unable to ack\n");
			}
		}
		break;
	}

	case MQTT_EVT_PUBACK:
		if (evt->result != 0) {
			printk("MQTT PUBACK error %d\n", evt->result);
			break;
		}

		printk("[%s:%d] PUBACK packet id: %u\n", __func__, __LINE__,
		       evt->param.puback.message_id);
		break;

	case MQTT_EVT_SUBACK:
		if (evt->result != 0) {
			printk("MQTT SUBACK error %d\n", evt->result);
			break;
		}

		printk("[%s:%d] SUBACK packet id: %u\n", __func__, __LINE__,
		       evt->param.suback.message_id);
		break;

	default:
		printk("[%s:%d] default: %d\n", __func__, __LINE__,
		       evt->type);
		break;
	}
}


/**@brief Resolves the configured hostname and
 * initializes the MQTT broker structure
 */
static void broker_init(void)
{
	int err;
	struct addrinfo *result;
	struct addrinfo *addr;
	struct addrinfo hints = {
		.ai_family = AF_INET,
		.ai_socktype = SOCK_STREAM
	};

	err = getaddrinfo(CONFIG_AWS_HOSTNAME, NULL, &hints, &result);
	if (err) {
		printk("ERROR: getaddrinfo failed %d\n", err);

		return;
	}

	addr = result;
	err = -ENOENT;

	/* Look for address of the broker. */
	while (addr != NULL) {
		/* IPv4 Address. */
		if (addr->ai_addrlen == sizeof(struct sockaddr_in)) {
			struct sockaddr_in *broker4 =
				((struct sockaddr_in *)&broker);

			broker4->sin_addr.s_addr =
				((struct sockaddr_in *)addr->ai_addr)
				->sin_addr.s_addr;
			broker4->sin_family = AF_INET;
			broker4->sin_port = htons(8883);
			printk("IPv4 Address found 0x%08x\n",
			       broker4->sin_addr.s_addr);
			break;
		} else {
			printk("ai_addrlen = %u should be %u or %u\n",
			       (unsigned int)addr->ai_addrlen,
			       (unsigned int)sizeof(struct sockaddr_in),
			       (unsigned int)sizeof(struct sockaddr_in6));
		}

		addr = addr->ai_next;
		break;
	}

	/* Free the address. */
	freeaddrinfo(result);
}

static int provision(void)
{
	int err;

	err = tls_credential_add(CONFIG_NRF_CLOUD_SEC_TAG,
				 TLS_CREDENTIAL_CA_CERTIFICATE,
					AmazonRootCA3_pem,
					AmazonRootCA3_pem_len);
	if (err < 0) {
		printk("Failed to register ca certificate: %d",
		       err);
		return err;
	}
	err = tls_credential_add(CONFIG_NRF_CLOUD_SEC_TAG,
				 TLS_CREDENTIAL_PRIVATE_KEY,
				 private_pem_key,
				 private_pem_key_len);
	if (err < 0) {
		printk("Failed to register private key: %d",
		       err);
		return err;
	}
	err = tls_credential_add(CONFIG_NRF_CLOUD_SEC_TAG,
				 TLS_CREDENTIAL_SERVER_CERTIFICATE,
				 public_pem,
				 public_pem_len);
	if (err < 0) {
		printk("Failed to register public certificate: %d",
		       err);
		return err;
	}

	return 0;
}

static int provision_modem_key(void)
{
	static sec_tag_t sec_tag_list[] = {CONFIG_NRF_CLOUD_SEC_TAG};

#if defined(CONFIG_BSD_LIBRARY)
	{
		int err;

		/* Delete certificates */
		nrf_sec_tag_t sec_tag = CONFIG_NRF_CLOUD_SEC_TAG;

		for (nrf_key_mgnt_cred_type_t type = 0; type < 3; type++) {
			err = nrf_inbuilt_key_delete(sec_tag, type);
			printk("nrf_inbuilt_key_delete(%lu, %d) => result=%d",
				sec_tag, type, err);
		}

		/* Provision CA Certificate. */
		err = nrf_inbuilt_key_write(CONFIG_NRF_CLOUD_SEC_TAG,
					NRF_KEY_MGMT_CRED_TYPE_CA_CHAIN,
					AmazonRootCA3_pem,
					AmazonRootCA3_pem_len);
		if (err) {
			printk("NRF_CLOUD_CA_CERTIFICATE err: %d", err);
			return err;
		}

		/* Provision Private Certificate. */
		err = nrf_inbuilt_key_write(
			CONFIG_NRF_CLOUD_SEC_TAG,
			NRF_KEY_MGMT_CRED_TYPE_PRIVATE_CERT,
			private_pem_key,
			private_pem_key_len);
		if (err) {
			printk("NRF_CLOUD_CLIENT_PRIVATE_KEY err: %d", err);
			return err;
		}

		/* Provision Public Certificate. */
		err = nrf_inbuilt_key_write(
			CONFIG_NRF_CLOUD_SEC_TAG,
			NRF_KEY_MGMT_CRED_TYPE_PUBLIC_CERT,
				 public_pem,
				 public_pem_len);
		if (err) {
			printk("NRF_CLOUD_CLIENT_PUBLIC_CERTIFICATE err: %d",
				err);
			return err;
		}
	}
#else
  #error "Missing CONFIG_BSD_LIB"
#endif
}

/* Function to get the client id */
static int client_id_get(char *id)
{
#if !defined(NRF_CLOUD_CLIENT_ID)
#if defined(CONFIG_BSD_LIBRARY)
	int at_socket_fd;
	int bytes_written;
	int bytes_read;
	char imei_buf[IMEI_LEN + 1];
	int ret;

	at_socket_fd = nrf_socket(NRF_AF_LTE, 0, NRF_PROTO_AT);
	__ASSERT_NO_MSG(at_socket_fd >= 0);

	bytes_written = nrf_write(at_socket_fd, "AT+CGSN", 7);
	__ASSERT_NO_MSG(bytes_written == 7);

	bytes_read = nrf_read(at_socket_fd, imei_buf, IMEI_LEN);
	__ASSERT_NO_MSG(bytes_read == IMEI_LEN);
	imei_buf[IMEI_LEN] = 0;

	snprintf(id, CLIENT_ID_LEN + 1, "nrf-%s", imei_buf);

	ret = nrf_close(at_socket_fd);
	__ASSERT_NO_MSG(ret == 0);
#else
#error Missing NRF_CLOUD_CLIENT_ID
#endif /* defined(CONFIG_BSD_LIBRARY) */
#else
	memcpy(id, CONFIG_CLOUD_CLIENT_ID, CLOUD_CLIENT_ID_LEN + 1);
#endif /* !defined(NRF_CLOUD_CLIENT_ID) */

	return 0;
}

/**@brief Initialize the MQTT client structure
*/
static int client_init(struct mqtt_client *client)
{
	mqtt_client_init(client);
	provision();
	broker_init();

	int ret = client_id_get(client_id_buf);
	if (ret != 0) {
		return ret;
	}

	/* MQTT client configuration */
	client->broker = &broker;
	client->evt_cb = mqtt_evt_handler;
	client->client_id.utf8 = client_id_buf;
	client->client_id.size = CLIENT_ID_LEN;
	client->password = NULL;
	client->user_name = NULL;
	client->protocol_version = MQTT_VERSION_3_1_1;

	/* MQTT buffers configuration */
	client->rx_buf = rx_buffer;
	client->rx_buf_size = sizeof(rx_buffer);
	client->tx_buf = tx_buffer;
	client->tx_buf_size = sizeof(tx_buffer);

	/* MQTT transport configuration */
	client->transport.type = MQTT_TRANSPORT_SECURE;

	static sec_tag_t sec_tag_list[] = {CONFIG_NRF_CLOUD_SEC_TAG};
	struct mqtt_sec_config * tls_config = &(client->transport).tls.config;

	tls_config->peer_verify = 2;
	tls_config->cipher_list = NULL;
	tls_config->cipher_count = 0;
	tls_config->sec_tag_count = ARRAY_SIZE(sec_tag_list);
	tls_config->sec_tag_list = sec_tag_list;
	tls_config->hostname = CONFIG_AWS_HOSTNAME;

	return 0;

}

/**@brief Initialize the file descriptor structure used by poll.
*/
static int fds_init(struct mqtt_client *c)
{
	if (c->transport.type == MQTT_TRANSPORT_NON_SECURE) {
		fds.fd = c->transport.tcp.sock;
	} else {
#if defined(CONFIG_MQTT_LIB_TLS)
		fds.fd = c->transport.tls.sock;
#else
		return -ENOTSUP;
#endif
	}

	fds.events = POLLIN;

	return 0;
}

/**@brief Configures modem to provide LTE link. Blocks until link is
 * successfully established.
 */
static void modem_configure(void)
{
#if defined(CONFIG_LTE_LINK_CONTROL)
	if (IS_ENABLED(CONFIG_LTE_AUTO_INIT_AND_CONNECT)) {
		/* Do nothing, modem is already turned on
		 * and connected.
		 */
	} else {
		int err;

		printk("LTE Link Connecting ...\n");
		err = lte_lc_init_and_connect();
		__ASSERT(err == 0, "LTE link could not be established.");
		printk("LTE Link Connected!\n");
	}
#endif
}

void main(void)
{
	int err;
	//cJSON_InitHooks();
	cJSON_Init();
	/* The mqtt client struct */
	struct mqtt_client client;

	printk("The MQTT fota\n");

	modem_configure();

	client_init(&client);

	err = mqtt_connect(&client); if (err != 0) { printk("ERROR: mqtt_connect %d\n", err);
		return;
	}

	err = fds_init(&client);
	if (err != 0) {
		printk("ERROR: fds_init %d\n", err);
		return;
	}

	while (1) {
		err = poll(&fds, 1, K_SECONDS(CONFIG_MQTT_KEEPALIVE));
		if (err < 0) {
			printk("ERROR: poll %d\n", errno);
			break;
		}

		err = mqtt_live(&client);
		if (err != 0) {
			printk("ERROR: mqtt_live %d\n", err);
			break;
		}

		if ((fds.revents & POLLIN) == POLLIN) {
			err = mqtt_input(&client);
			if (err != 0) {
				printk("ERROR: mqtt_input %d\n", err);
				break;
			}
		}

		if ((fds.revents & POLLERR) == POLLERR) {
			printk("POLLERR\n");
			break;
		}

		if ((fds.revents & POLLNVAL) == POLLNVAL) {
			printk("POLLNVAL\n");
			break;
		}

	}

	printk("Disconnecting MQTT client...\n");

	err = mqtt_disconnect(&client);
	if (err) {
		printk("Could not disconnect MQTT client. Error: %d\n", err);
	}
}
```

## src/aws_jobs_dfu.c
```c
#include <zephyr.h>
#include <stdio.h>
#include <net/mqtt.h>
#include <fota_download.h>
#include "aws_jobs_dfu.h"
#include <cJSON.h>

/*
 * Jobdocument structure
 * {
 *	operation: <json obj> (currently only app_fw_update)
 *	fwversion: string
 *	size: number
 *	location: string
 * }
 */

/* Job execution document
 * {
 * 	jobId: string
 * 	status:string<job_execution_status>
 * 	statusDetails: {
 * 		//nrfcloud specific
 * 		nextState: string<FotaStatus>
 * 	}
 * 	queuedAt: number<time>
 *
 */

/* Simple state flow overview
 * Queue job
 * device notfied of job
 * device update job with in progress
 * device initiates download from http
 * update fota status with download firmware
 * firmware downloaded
 * update fota status with apply firmware
 * update with success
 * reboot
 */

/* The max JOB_ID_LEN according to AWS docs
 * https://docs.aws.amazon.com/general/latest/gr/aws_service_limits.html#job-limits
 */

#define JOB_ID_MAX_LEN 64
#define STATUS_MAX_LEN 12
#define IMEI_LEN 15
#define CLIENT_ID_LEN (IMEI_LEN + 4)

#define AWS "$aws/things/"
#define AWS_LEN (sizeof(AWS) - 1)

#define JOBS_NOTIFY_NEXT_TOPIC AWS "%s/jobs/notify-next"
#define JOBS_NOTIFY_NEXT_TOPIC_LEN (AWS_LEN + CLIENT_ID_LEN + 18)

#define JOBS_GET_TOPIC AWS "%s/jobs/get/#"
#define JOBS_GET_TOPIC_LEN (AWS_LEN + CLIENT_ID_LEN + 11)

#define JOBS_GET_JOBID_TOPIC AWS "%s/jobs/%s/get/#"
#define JOBS_GET_JOBID_TOPIC_MAX_LEN (AWS_LEN +\
				      CLIENT_ID_LEN +\
				      JOB_ID_MAX_LEN +\
				      13)
#define JOBS_GET_JOBID_TOPIC_SPECIFIED AWS "%s/jobs/%s/get/%s"
#define JOBS_GET_JOBID_TOPIC_SPECIFIED_MAX_LEN (AWS_LEN +\
						CLIENT_ID_LEN +\
						JOB_ID_MAX_LEN + 12 + 9 + 2)
//#define JOBS_GET_JOBID_TOPIC_LEN (AWS_LEN + CLIENT_ID_LEN + JOB_ID_MAX_LEN + 12)

/* For future use-cases */
#define JOBS_NOTIFY_TOPIC AWS "%s/jobs/notify"
#define JOBS_NOTIFY_TOPIC_LEN (AWS_LEN + CLIENT_ID_LEN + 12)

/* Topic for updating shadow topic with version number */
#define UPDATE_DELTA_TOPIC AWS "%s/shadow/update"
#define UPDATE_DELTA_TOPIC_LEN (AWS_LEN + CLIENT_ID_LEN + 14)

#define JOBS_UPDATE_TOPIC AWS "%s/jobs/%s/update"
#define JOBS_UPDATE_TOPIC_LEN (AWS_LEN + CLIENT_ID_LEN + JOB_ID_MAX_LEN + 14)
//TODO: Switch this back
//#define SHADOW_STATE_UPDATE "{\"state\":{\"reported\":{\"nrfcloud__fota_v1__app_v\":\"%s\"}}}"
#define SHADOW_STATE_UPDATE "{\"state\":{\"reported\":{\"nrfcloud__fota_v1__app_v\":%d}}}"

#define JOBS_UPDATE_PAYLOAD "{\"status\":\"%s\",\"statusDetails\":{\"nextState\":\"%s\"},\
			    \"expectedVersion\": %d, \"includeJobExecutionState\": true,\
			    \"clientToken\": \"%s\"}"

/* Enum for tracking the job exectuion state */
static enum job_execution_status execution_state;
static enum fota_status fota_state;

/* Global local counter which contains the expected job document version,
 * this needs to match what the AWS jobs document contains if not
 * the update using that expectedVersionNumber will be rejected
 * https://docs.aws.amazon.com/iot/latest/developerguide/jobs-api.html#mqtt-updatejobexecution
 */
static int document_version_number = 0;

/* Client struct pointer for MQTT */
struct mqtt_client * client;

/* This is generated for each job by the client */
static char client_token_buf[64];

/* Staticly allocated buffers for keeping the topics needed for AWS jobs */
static u8_t jobs_notify_next_topic[JOBS_NOTIFY_NEXT_TOPIC_LEN + 1];
static u8_t jobs_get_jobid_updated_accepted_topic[JOBS_GET_JOBID_TOPIC_MAX_LEN+ 1];
static u8_t jobs_get_jobid_updated_rejected_topic[JOBS_GET_JOBID_TOPIC_MAX_LEN+ 1];

/* Buffer to keep the current job_id */
static u8_t job_id_buf[JOB_ID_MAX_LEN];
/* Create a sensible max (maybe 255?) */
static u8_t hostname[CONFIG_MQTT_MESSAGE_BUFFER_SIZE];
static u8_t file_path[CONFIG_MQTT_MESSAGE_BUFFER_SIZE];

static u8_t jobs_jobid_update_topic[JOBS_UPDATE_TOPIC_LEN + 1];
static u8_t jobs_jobid_update_accepted_topic[JOBS_UPDATE_TOPIC_LEN + 1];

int publish_data_to_topic(struct mqtt_client * c,
			  char * topic,
			  int topic_len,
			  char * data,
			  int data_len)
{
	struct mqtt_publish_param param;
	param.message.topic.qos = 1;
	param.message.topic.topic.utf8 = topic;
	param.message.topic.topic.size = topic_len;
	param.message.payload.data = data;
	param.message.payload.len = data_len;
	param.message_id = sys_rand32_get();
	param.dup_flag = 0;
	param.retain_flag = 0;

	printk("Publishing document\n");
	int err = mqtt_publish(c, &param);
	if(err) {
		printk("unable to publish update document\n");
		return -1;// -ERR;
	}

	return 0;//expected_version;
}

static int update_job_execution_status(struct mqtt_client * c,
		      		       enum job_execution_status status,
		      		       char * job_id,
		      		       enum fota_status next_state,
		      		       int expected_version)
{
	/* Max size document is 1350 char but the max size json document is actually 32kb
	 * set it to what is the limiting factor which is the MQTT buffer size on the
	 * reception end
	 */
	u8_t update_job_document[CONFIG_MQTT_MESSAGE_BUFFER_SIZE];

	int ret = snprintf(jobs_jobid_update_topic,
			   JOBS_UPDATE_TOPIC_LEN,
		           JOBS_UPDATE_TOPIC,
			   c->client_id.utf8,
			   job_id);

	/* TODO: Add error check
	if (ret < JOBS_UPDATE_TOPIC_LEN) {
		return -ENOMEM;
	}*/
	printk("Publishing to topic: %s\n", jobs_jobid_update_topic);

	ret = snprintf(update_job_document,
		       ARRAY_SIZE(update_job_document),
		       JOBS_UPDATE_PAYLOAD,
		       job_execution_status_map[status],
		       fota_status_map[next_state],
		       expected_version,
		       /*TODO: Place holder until I know what to do with it */
		       "SomeClientToken");

	printk("document: %s\n", update_job_document);

	/* TODO: Not sure you can do error checking for this case */
	/*
	if (ret < ARRAY_SIZE(update_job_document)) {
		return -ENOMEM;
	}
	*/

	/* Increment version number by 1 as expected by AWS */
	//expected_version = expected_version + 1;

	ret = publish_data_to_topic(c,
		      jobs_jobid_update_topic,
		      strlen(jobs_jobid_update_topic),
		      update_job_document,
		      strlen(update_job_document)
		     );
	if(ret)
	{
		return ret;
	}

	document_version_number = expected_version + 1;
	return ret;


}



void aws_jobs_handler(struct mqtt_client * c,
			     u8_t * topic,
			     u8_t * json_payload)
{
	int err;
	printk("Entered aws_jobs hander with topic: %s\n\r payload: %s", topic, json_payload);
	if (!strncmp(jobs_notify_next_topic, topic, strlen(topic)))
	{
		/* Accepting update job */
		err = parse_job_document(json_payload);
		subscribe_to_job_id_topics(c, job_id_buf);

		execution_state = IN_PROGRESS;
		fota_state = DOWNLOAD_FIRMWARE;

		err = fota_download_start(hostname, file_path);

		if (err) {
			execution_state = FAILED;
			fota_state = NONE;
			update_job_execution_status(c,
						    execution_state,
						    job_id_buf,
					            fota_state,
					            document_version_number);
			return;
		}

		update_job_execution_status(c,
					    execution_state,
					    job_id_buf,
					    fota_state,
					    document_version_number);
		/* Handle error state where you can't start the fota
		}*/


		//expected_document_version_number = accept_job(job_id);
		//unsubscribe_notify_next_topic(c);
	}
	else if (!strncmp(jobs_jobid_update_accepted_topic,
			  topic,
			  strlen(topic)
			  )
		)
	{
		if (execution_state == IN_PROGRESS)
		{
			/* Update document version number */

		}
		else if (execution_state == SUCCEEDED &&
			 fota_state == APPLY_FIRMWARE)
		{
			/* Download completed and reported initiate system reset */
			//NVIC_SystemReset();
		}
	}
	else
	{
	}
}

int parse_job_document(u8_t * json_payload)
{
	cJSON * json = cJSON_Parse(json_payload);
	cJSON * document = cJSON_GetObjectItemCaseSensitive(json, "execution");
	if(!document){
		cJSON_free(json);
		return -EINVAL;
	}
	cJSON * job_id = cJSON_GetObjectItemCaseSensitive(document, "jobId");
	if (cJSON_IsString(job_id) && (job_id->valuestring != NULL))
	{
		printk("\r\nJobId: %s \n", job_id->valuestring);
		memcpy(job_id_buf,
		       job_id->valuestring,
		       strlen(job_id->valuestring));
	}

	cJSON * version_number = cJSON_GetObjectItemCaseSensitive(document, "versionNumber");
	if (cJSON_IsNumber(version_number))
	{
		printk("versionNumber: %d \n", version_number->valueint);
		document_version_number = version_number->valueint;
	}
	else
	{
		return -EINVAL;
	}


	cJSON * job_document = cJSON_GetObjectItemCaseSensitive(document, "jobDocument");
	cJSON * fw_version = cJSON_GetObjectItemCaseSensitive(job_document, "fwversion");
	if (cJSON_IsNumber(fw_version))
	{
		printk("fw_version: %d \n", fw_version->valueint);
	}
	cJSON * location_document = cJSON_GetObjectItemCaseSensitive(job_document, "location");
	cJSON * host = cJSON_GetObjectItemCaseSensitive(location_document, "host");
	if (cJSON_IsString(host) && (host->valuestring != NULL))
	{
		memcpy(hostname, host->valuestring, strlen(host->valuestring));
	}

	cJSON * path = cJSON_GetObjectItemCaseSensitive(location_document, "path");
	if(cJSON_IsString(path) && (path->valuestring != NULL))
	{
		memcpy(file_path, path->valuestring, strlen(path->valuestring));
	}
	printk("host: %s, path:%s \n", hostname, file_path);
	cJSON_free(json);


	return 0;
}

/*
static int notify_next_handler(struct mqtt_client *c, u8_t * json_string)
{
	int job_version_number = 0;
	cJSON * json = cJSON_Parse(json_string);
	cJSON * document = cJSON_GetObjectItemCaseSensitive(json, "execution");
	if(!document){
		cJSON_free(json);
		return -EFAULT;
	}
	cJSON * job_id = cJSON_GetObjectItemCaseSensitive(document, "jobId");
	if (cJSON_IsString(job_id) && (job_id->valuestring != NULL))
	{
		printk("JobId: %s \n", job_id->valuestring);
		memcpy(g_job_id,
		       job_id->valuestring,
		       strlen(job_id->valuestring));
	}
	cJSON * status = cJSON_GetObjectItemCaseSensitive(document, "status");
	if (cJSON_IsString(status) && (status->valuestring != NULL))
	{
		printk("status: %s \n", status->valuestring);
	}
	cJSON * document_version_number = cJSON_GetObjectItemCaseSensitive(document, "versionNumber");
	if (cJSON_IsNumber(document_version_number))
	{
		printk("versionNumber: %d \n", document_version_number->valueint);
		job_version_number = document_version_number->valueint;
	}

	return job_version_number;
}
*/


/*
 * Dispatcher for handling job updates the FSM state
 */
static void aws_jobs_update_handler(struct mqtt_client * c,
				    u8_t * topic,
				    u8_t * json_payload)
{
}


static int publish_version_to_device_shadow(struct mqtt_client *c,
					    const char * app_version)
{
	char update_delta_topic[UPDATE_DELTA_TOPIC_LEN + 1];
	u8_t data[CONFIG_MQTT_MESSAGE_BUFFER_SIZE];

	struct mqtt_publish_param param;

	int ret = snprintf(update_delta_topic, sizeof(update_delta_topic),
		       UPDATE_DELTA_TOPIC, c->client_id.utf8);

	if (ret != UPDATE_DELTA_TOPIC_LEN) {
		return -ENOMEM;
	}

	snprintf(data, ARRAY_SIZE(data), SHADOW_STATE_UPDATE, app_version);

	return publish_data_to_topic(c,
			      update_delta_topic,
			      UPDATE_DELTA_TOPIC_LEN,
			      data,
			      strlen(data)
			     );
}


/*
 * Generic method for updating the Job status with the correct information
static int update_job_execution(struct mqtt_client * c,
				const char * status,
				const char * job_id)
{
}
 */

int construct_notify_next_topic(struct mqtt_client * c)
{
	int ret = snprintf(jobs_notify_next_topic,
			   JOBS_NOTIFY_NEXT_TOPIC_LEN,
		           JOBS_NOTIFY_NEXT_TOPIC,
			   c->client_id.utf8);
	//TODO: Find a way to error check this
	return 0;
}

int subscribe_to_jobs_notify_next(struct mqtt_client * c)
{
	__ASSERT(strlen(jobs_notify_next) != NULL,
			"Jobs notify next has not been constructed")
	struct mqtt_topic subscribe_topic [] =
	{
		{
			.topic = {
				.utf8 = jobs_notify_next_topic,
				.size = strlen(jobs_notify_next_topic)
			},
			.qos = MQTT_QOS_1_AT_LEAST_ONCE
		},
	};

	printk("Subscribing to: %s\r\n", jobs_notify_next_topic);

	const struct mqtt_subscription_list subscription_list = {
		.list = (struct mqtt_topic *)&subscribe_topic,
		.list_count = 1,
		.message_id = 1234
	};

	return mqtt_subscribe(c, &subscription_list);
}

fota_download_callback_t aws_fota_dl_handler(const struct fota_download_evt * evt)
{
	printk("=?=Fota callback recived===\n");
	if (evt->id == FOTA_DOWNLOAD_EVT_DOWNLOAD_CLIENT &&
		evt->dlc_evt->id == DOWNLOAD_CLIENT_EVT_DONE) {
		execution_state = SUCCEEDED;
		fota_state = APPLY_FIRMWARE;
		update_job_execution_status(client,
					    execution_state,
					    job_id_buf,
					    fota_state,
					    document_version_number);
	}
	//TODO: Handle fragments to give updates on progress to cloud
}

/* Topics which needs to be subscribed to for getting notfied of a job and updates
 * https://docs.aws.amazon.com/iot/latest/developerguide/jobs-devices.html */
int subscribe_to_job_id_topics(struct mqtt_client * c, const char * job_id)
{
	/* We subscribe to both accepted and rejected so we do get/# to simplify our code */
	char jobs_get_jobid_topic[JOBS_GET_JOBID_TOPIC_MAX_LEN + 1];
	int ret = snprintf(jobs_get_jobid_topic,
			   JOBS_GET_JOBID_TOPIC_MAX_LEN,
			   JOBS_GET_JOBID_TOPIC,
			   c->client_id.utf8,
			   job_id);

	/*
	if (ret != JOBS_GET_TOPIC_LEN)
	{
		return -ENOMEM;
	}
	*/

	printk("Jobs get jobid: %s\n", jobs_get_jobid_topic);

	/* Generate subscription list, if you update this update the list_count */
	struct mqtt_topic subscribe_topic []= {
		{
			.topic = {
				.utf8 = jobs_get_jobid_topic,
				.size = strlen(jobs_get_jobid_topic)
			},
			.qos = MQTT_QOS_1_AT_LEAST_ONCE
		},
	};

	const struct mqtt_subscription_list subscription_list = {
		.list = (struct mqtt_topic *)&subscribe_topic,
		.list_count = 1, //TODO: Find out if ARRAY_SIZE(subscribe_topic) works?
		.message_id = 111  //TODO: Find a good message_id number?
	};

	return mqtt_subscribe(c, &subscription_list);
}

/*
 * Subscribe to the specific topics bounded to the current jobId this should only
 * be done once you have accepted a job
 */
int subscribe_to_job_id_topic(struct mqtt_client * c)
{
	char jobs_get_jobid_topic[JOBS_GET_JOBID_TOPIC_SPECIFIED_MAX_LEN  + 1];
	int ret = snprintf(jobs_get_jobid_topic,
			  JOBS_GET_JOBID_TOPIC_SPECIFIED_MAX_LEN,
		          JOBS_GET_JOBID_TOPIC_SPECIFIED,
		          c->client_id.utf8,
		          job_id_buf,
			  "accepted"
			  );
	return ret;
}

//int aws_jobs_init(struct mqtt_client * c, const char * app_version)
int aws_jobs_init(struct mqtt_client * c)
{
	client = c;
	int err = construct_notify_next_topic(c);
	if (err) {
		return err; //ERR
	}

	err = subscribe_to_jobs_notify_next(c);
	if (err) {
		return err; //ERR
	}

	err = publish_version_to_device_shadow(c,"1");
	if (err) {
		return err; //ERR
	}


	err = fota_download_init(aws_fota_dl_handler);
	if (err) {
		return err; //ERR
	}

	return 0;

}
```

## src/aws_jobs_dfu.h
```c
#ifndef __APP_DFU
#define __APP_DFU
/* Enum to keep the fota status */
enum fota_status {
	DOWNLOAD_FIRMWARE = 0,
	APPLY_FIRMWARE,
	NONE
};

/* Map of fota status to report back */
const char * fota_status_map [] = {
	"download_firmware",
	"apply_update",
	"none"
};

/* Maybe status or event ?*/
/* Enum to keep the AWS job status */
enum job_execution_status {
	QUEUED = 0,
	IN_PROGRESS,
	SUCCEEDED,
	FAILED,
	TIMED_OUT,
	REJECTED,
	REMOVED,
	CANCELED
};

/* Map of enum job status enum to strings */
const char * job_execution_status_map [] = {
	"QUEUED",
	"IN_PROGRESS",
	"SUCCEEDED",
	"FAILED",
	"TIMED_OUT",
	"REJECTED",
	"REMOVED",
	"CANCELED"
};

/*
 * AWS job handler which should handle incoming mqtt publish events
 * on AWS specific topics
 */
void aws_jobs_handler(struct mqtt_client * c,
			     u8_t * topic,
			     u8_t * json_payload);
/*
 * Initializes the global client struct that is used in callbacks
 * and subscribes required topics for AWS jobs
 */
int aws_jobs_init(struct mqtt_client * c);
#endif
```

## src/dfu_thread.c
```c
#include <stdint.h>
#include <zephyr.h>
#include <flash.h>
#include <download_client.h>
#include <dfu/mcuboot.h>
/* Support both PM and dtc */
#include <pm_config.h>

static bool		is_flash_page_erased[FLASH_PAGE_MAX_CNT];
static struct		device	*flash_dev;
static u32_t		flash_address;


struct k_thread dfu_thread;
K_THREAD_STACK_DEFINE(dfu_stack_area, 4096);

/* Forward decleration of download_client_event_handler */
static int download_client_evt_handler(const struct download_client_evt * event);
static struct download_client dfu;

/**@brief Initialize flash device and set flash start addr. */
static int flash_init(void)
{

	flash_address = PM_MCUBOOT_SECONDARY_ADDRESS;
	for (int i = 0; i < FLASH_PAGE_MAX_CNT; i++) {
		is_flash_page_erased[i] = false;
	}
	flash_dev = device_get_binding(DT_FLASH_DEV_NAME);
	if (flash_dev == 0) {
		printk("Nordic nRF flash driver was not found!\n");
		return 1;
	}

}

static int flash_page_erase_if_needed(u32_t address)
{
	int err;
	struct flash_pages_info info;

	err = flash_get_page_info_by_offs(flash_dev, address,
		&info);
	if (err != 0) {
		printk("flash_get_page_info_by_offs returned error %d\n",
			err);
		return 1;
	}
	if (!is_flash_page_erased[info.index]) {
		err = flash_write_protection_set(flash_dev, false);
		if (err != 0) {
			printk("flash_write_protection_set returned error %d\n",
				err);
			return 1;
		}
		err = flash_erase(flash_dev, info.start_offset, info.size);
		if (err != 0) {
			printk("flash_erase returned error %d at address %08x\n",
				err, info.start_offset);
			return 1;
		}
		is_flash_page_erased[info.index] = true;
		err = flash_write_protection_set(flash_dev, true);
		if (err != 0) {
			printk("flash_write_protection_set returned error %d\n",
				err);
			return 1;
		}
	}
	return 0;
}

int start_dfu(char * hostname,
	      char * resource_path)
{
	flash_init();
	printk("dfu: hostname %s, resource_path: %s \n\r", hostname, resource_path);

	dfu.host = hostname;
	dfu.file = resource_path;
	int retval = download_client_init(&dfu, download_client_evt_handler);
	printk("download client initialized\n\r");
	printk(" hostname: %s, resource: %s\n\r", hostname, resource_path);

	if (retval != 0) {
		printk("download_client_init() failed, err %d", retval);
		return -EFAULT;
	}
	retval = download_client_connect(&dfu, hostname);
	printk("download client connected\n\r");

	if (retval != 0) {
		printk("download_client_connect() failed, err %d",
			retval);
		return -EFAULT;
	}

	retval = download_client_start(&dfu, resource_path, 0);
	if (retval != 0) {
		printk("download_client_start() failed, err %d",
			retval);
		return -EFAULT;
	}
	printk("download client started\n\r");
	return 0;
}



static int download_client_evt_handler(const struct download_client_evt * event)
{
	int err;

	printk("event recived\n");
	switch (event->id) {
	case DOWNLOAD_CLIENT_EVT_FRAGMENT: {
		printk("Fragment recived\n");

		if (dfu.file_size > PM_MCUBOOT_SECONDARY_SIZE) {
			printk("Requested file too big to fit in flash\n");
			return 1;
		}
		err = flash_page_erase_if_needed(flash_address);
		if (err != 0) {
			return 1;
		}
		err = flash_write_protection_set(flash_dev, false);
		if (err != 0) {
			printk("flash_write_protection_set returned error %d\n",
				err);
			return 1;
		}
		err = flash_write(flash_dev, flash_address, event->fragment.buf,
							event->fragment.len);
		if (err != 0) {
			printk("Flash write error %d at address %08x\n",
				err, flash_address);
			return 1;
		}
		err = flash_write_protection_set(flash_dev, true);
		if (err != 0) {
			printk("flash_write_protection_set returned error %d\n",
				err);
			return 1;
		}
		flash_address += event->fragment.len;
		printk("Flash addr: 0x%x \n");
		break;
	}

	case DOWNLOAD_CLIENT_EVT_DONE:
		flash_address = PM_MCUBOOT_SECONDARY_ADDRESS
				+ PM_MCUBOOT_SECONDARY_SIZE
				- 0x4;
		err = flash_page_erase_if_needed(flash_address);
		if (err != 0) {
			return 1;
		}
		err = boot_request_upgrade(0);
		if (err != 0) {
			printk("boot_request_upgrade returned error %d\n", err);
			return 1;
		}
		printk("DOWNLOAD_CLIENT_EVT_DOWNLOAD_DONE");
		download_client_disconnect(&dfu);
		break;

	case DOWNLOAD_CLIENT_EVT_ERROR: {
		download_client_disconnect(&dfu);
		printk("Download client error, please restart "
			"the application\n");
		break;
	}
	default:
		break;
	}
	return 0;
}

void dfu_thread_entry_point(void * in_hostname,
			    void * in_resource_path,
			    void * unused)
{
	char * hostname = (char *) in_hostname;
	char * resource_path = (char *) in_resource_path;

	start_dfu(hostname, resource_path);
	/*
	while (1) {
		if ((dfu.status == DOWNLOAD_CLIENT_STATUS_HALTED) ||
			(dfu.status == DOWNLOAD_CLIENT_ERROR)) {
			printk("Something went wrong, please restart the application\n");
			return 1;
		} else if (dfu.status ==
			DOWNLOAD_CLIENT_STATUS_DOWNLOAD_COMPLETE) {
			printk("Download complete\n");
			break;
		}
		//download_client_process(&dfu);
	}
	*/
	return;

}

void dfu_start_thread(char * hostname, char * resource_path)
{
	printk("dfu_start hostname: %s, resource: %s\n\r",
	       hostname,
	       resource_path);
	k_tid_t dfu_tid = k_thread_create(&dfu_thread,
					  dfu_stack_area,
					  K_THREAD_STACK_SIZEOF(dfu_stack_area),
					  dfu_thread_entry_point,
					  hostname,
					  resource_path,
					  NULL,
					  5,
					  0,
					  K_NO_WAIT);
}
```
