## CMakeLists.txt
```
#
# Copyright (c) 2020 Nordic Semiconductor ASA
#
# SPDX-License-Identifier: LicenseRef-BSD-5-Clause-Nordic
#

cmake_minimum_required(VERSION 3.8.2)

include($ENV{ZEPHYR_BASE}/../nrf/cmake/boilerplate.cmake)
include($ENV{ZEPHYR_BASE}/cmake/app/boilerplate.cmake NO_POLICY_SCOPE)
project(network_core_bootloader)

zephyr_library_sources(src/main.c)
```

## Kconfig
```
#
# Copyright (c) 2020 Nordic Semiconductor ASA
#
# SPDX-License-Identifier: LicenseRef-BSD-5-Clause-Nordic
#

menu "nRF5340 Network Core Bootloader Sample Settings"

config NETBOOT_MIN_PARTITION_SIZE
	bool "Use minimimum partition size"
endmenu

menu "Zephyr Kernel"
source "$ZEPHYR_BASE/Kconfig.zephyr"
endmenu
```

## sample.yaml
```
sample:
  name: netboot Sample
tests:
  samples.nrf5340.netboot:
    build_only: true
    build_on_all: true
    platform_whitelist: nrf5340dk_nrf5340_cpunet nrf5340pdk_nrf5340_cpunet
    tags: ci_build
  samples.nrf5340.netboot.minimal_size:
    build_only: true
    build_on_all: true
    platform_whitelist: nrf5340dk_nrf5340_cpunet nrf5340pdk_nrf5340_cpunet
    extra_args: OVERLAY_CONFIG=overlay-minimal-size.conf
    tags: ci_build
```

## prj.conf
```kconfig
#
# Copyright (c) 2020 Nordic Semiconductor ASA
#
# SPDX-License-Identifier: LicenseRef-BSD-5-Clause-Nordic
#
CONFIG_NCS_SAMPLES_DEFAULTS=y

CONFIG_MULTITHREADING=n
CONFIG_GPIO=n
CONFIG_GEN_IRQ_VECTOR_TABLE=n
CONFIG_ARM_MPU=n
CONFIG_SYS_POWER_MANAGEMENT=n
CONFIG_TICKLESS_IDLE=n
CONFIG_ERRNO=n
CONFIG_SYS_CLOCK_EXISTS=y
CONFIG_NRF_RTC_TIMER=n
CONFIG_CLOCK_CONTROL=n
CONFIG_FPROTECT=y
CONFIG_FW_INFO=y
CONFIG_IS_SECURE_BOOTLOADER=y
CONFIG_SECURE_BOOT_CRYPTO=y
CONFIG_SECURE_BOOT_VALIDATION=y
CONFIG_SECURE_BOOT_STORAGE=y
CONFIG_PCD=y
CONFIG_FLASH=y
CONFIG_FLASH_PAGE_LAYOUT=y
```

## overlay-minimal-size.conf
```kconfig
#
# Copyright (c) 2020 Nordic Semiconductor ASA
#
# SPDX-License-Identifier: LicenseRef-BSD-5-Clause-Nordic
#

# To reduce size, turn off debug configs, and enable minimal partition size
CONFIG_NETBOOT_MIN_PARTITION_SIZE=y
CONFIG_NCS_SAMPLES_DEFAULTS=n
CONFIG_LOG=n
CONFIG_BOOT_BANNER=n
CONFIG_PRINTK=n
CONFIG_CONSOLE=n
CONFIG_UART_CONSOLE=n # Set explicitly to 'n' to avoid Kconfig warning
CONFIG_SERIAL=n
CONFIG_SECURE_BOOT_DEBUG=n
CONFIG_ASSERT=n
CONFIG_NRF_RTC_TIMER=n
CONFIG_RESET_ON_FATAL_ERROR=n
CONFIG_REBOOT=n
CONFIG_SYSTEM_CLOCK_DISABLE=n
CONFIG_SYS_CLOCK_EXISTS=n
CONFIG_TIMEOUT_64BIT=n
```

## src/main.c
```c
/*
 * Copyright (c) 2020 Nordic Semiconductor ASA
 *
 * SPDX-License-Identifier: LicenseRef-BSD-5-Clause-Nordic
 */

#include <zephyr/types.h>
#include <sys/printk.h>
#include <pm_config.h>
#include <fw_info.h>
#include <fprotect.h>
#include <bl_storage.h>
#include <bl_boot.h>
#include <bl_validation.h>
#include <dfu/pcd.h>
#include <device.h>

#define FLASH_NAME DT_CHOSEN_ZEPHYR_FLASH_CONTROLLER_LABEL

void main(void)
{
	int err = fprotect_area(PM_B0N_ADDRESS, PM_B0N_SIZE);
	struct device *fdev = device_get_binding(FLASH_NAME);

	if (err) {
		printk("Failed to protect b0n flash, cancel startup\n\r");
		goto failure;
	}

	uint32_t s0_addr = s0_address_read();
	bool valid = false;

	if (pcd_fw_copy_status_get() == PCD_STATUS_COPY) {
		/* First we validate the data where the PCD CMD tells
		 * us that we can find it.
		 */
		uint32_t update_addr = (uint32_t)pcd_cmd_data_ptr_get();

		valid = bl_validate_firmware(s0_addr, update_addr);
		if (!valid) {
			printk("Unable to find valid firmware inside %p\n\r",
				(void *)update_addr);
			goto failure;
		}

		err = pcd_fw_copy(fdev);
		if (err != 0) {
			printk("Failed to transfer image: %d\n\r", err);
			goto failure;
		}

		/* Note that only the SHA is validated, no signature
		 * check is performed. This because the signature validation
		 * is performed by the application core. This check is only
		 * done to verify that the flash copy operation was successful.
		 */
		valid = bl_validate_firmware(s0_addr, s0_addr);
		if (valid) {
			pcd_fw_copy_done();
		} else {
			printk("Unable to find valid firmware inside %p\n\r",
				(void *)s0_addr);
			goto failure;
		}

		/* Success, waiting to be rebooted */
		while (1)
			;
		CODE_UNREACHABLE;
	}

	err = fprotect_area(PM_APP_ADDRESS, PM_APP_SIZE);
	if (err) {
		printk("Failed to protect app flash: %d\n\r", err);
		goto failure;
	}

	bl_boot(fw_info_find(s0_addr));
	return;

failure:
	pcd_fw_copy_invalidate();
}
```
