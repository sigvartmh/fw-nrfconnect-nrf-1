## prj.conf
```kconfig
CONFIG_HEAP_MEM_POOL_SIZE=4096

CONFIG_THREAD_CUSTOM_DATA=y
CONFIG_BOARD_ENABLE_CPUNET=y

CONFIG_NRF_RPC=y
CONFIG_NRF_RPC_CBOR=y
CONFIG_NRF_RPC_THREAD_STACK_SIZE=4096

CONFIG_LOG=y
CONFIG_LOG_MODE_MINIMAL=y
CONFIG_NRF_RPC_LOG_LEVEL_INF=y
CONFIG_NRF_RPC_TR_LOG_LEVEL_INF=y
CONFIG_NRF_RPC_OS_LOG_LEVEL_INF=y

# Uncommend to allow better debugging
#CONFIG_NO_OPTIMIZATIONS=y
#CONFIG_DEBUG=y
```

## src/main.c
```c
/*
 * Copyright (c) 2020 Nordic Semiconductor ASA
 *
 * SPDX-License-Identifier: LicenseRef-Nordic-5-Clause
 */

#include <zephyr/kernel.h>
#include <zephyr/logging/log.h>

#include <nrf_rpc.h>
#include <nrf_rpc/nrf_rpc_ipc.h>
#include <nrf_rpc_cbor.h>

#include "entropy_ser.h"

#define BUFFER_LENGTH 10
LOG_MODULE_REGISTER(appcore, 4);

static uint8_t buffer[BUFFER_LENGTH];

static void entropy_print(const uint8_t *buffer, size_t length)
{
	for (size_t i = 0; i < length; i++) {
		printk("  0x%02x", buffer[i]);
	}

	printk("\n");
}


static void result_callback(int result, uint8_t *buffer, size_t length)
{
	if (result) {
		LOG_ERR("Entropy remote get failed: %d\n", result);
		return;
	}

	entropy_print(buffer, length);
}

int main(void)
{
	int err;

	LOG_INF("Flash API.");

	err = flash_remote_api_init();
	if (err) {
		LOG_ERR("Remote flash driver initialization failed");
		return 0;
	}

	LOG_INF("Flash API initialized.");

	char buff[32] = "this is a 2 recompiled-test";


	err = flash_remote_write(0x10000, buff, 32);
	if (err) {
		LOG_ERR("Remote flash write failed");
		return 0;
	}

	char buff2[32] = "herpa derpa du";

	LOG_INF("Buff addr: 0x%x", (uint32_t)buff2);
	err = flash_remote_read(0x10000, buff2, 32);
	if (err) {
		LOG_ERR("Remote flash read failed");
		return 0;
	}
	LOG_INF("buff2: %s", buff2);

	err = flash_remote_erase(0x10000, 0x1000);
	if (err) {
		LOG_ERR("Remote flash erase failed");
		return 0;
	}

	err = flash_remote_read(0x10000, buff2, 32);
	if (err) {
		LOG_ERR("Remote flash read failed");
		return 0;
	}
	LOG_INF("buff2: %s", buff2);


	while (true) {
		k_sleep(K_MSEC(2000));
	}
}
```

## src/entropy_ser.c
```c
/*
 * Copyright (c) 2020 Nordic Semiconductor ASA
 *
 * SPDX-License-Identifier: LicenseRef-Nordic-5-Clause
 */
#include <errno.h>
#include <zephyr/init.h>
#include <zephyr/logging/log.h>
#include <string.h>

#include <nrf_rpc/nrf_rpc_ipc.h>
#include <nrf_rpc_cbor.h>

#include "../../common_ids.h"
#include <zcbor_common.h>
#include <zcbor_decode.h>

#include <zcbor_encode.h>

LOG_MODULE_REGISTER(app_rpc, 4);

NRF_RPC_IPC_TRANSPORT(flash_netcore_api_tr, DEVICE_DT_GET(DT_NODELABEL(ipc0)), "flash_api_net_ept");
NRF_RPC_GROUP_DEFINE(flash_netcore_api, "flash_api_network_core", &flash_netcore_api_tr, NULL, NULL,
		     NULL);

#define CBOR_BUF_FLASH_MSG_SIZE (sizeof(void *) + sizeof(size_t) + sizeof(off_t))

void rsp_error_code_handle(const struct nrf_rpc_group *group, struct nrf_rpc_cbor_ctx *ctx,
			   void *handler_data)
{
	int32_t val;

	if (zcbor_int32_decode(ctx->zs, &val)) {
		*(int *)handler_data = (int)val;
	} else {
		*(int *)handler_data = -NRF_EINVAL;
	}
}

int flash_remote_api_init(void)
{
	int result;
	int err;
	struct nrf_rpc_cbor_ctx ctx;

	/* TODO: Check Size */
	NRF_RPC_CBOR_ALLOC(&flash_netcore_api, ctx, CBOR_BUF_FLASH_MSG_SIZE);

	err = nrf_rpc_cbor_cmd(&flash_netcore_api, RPC_COMMAND_FLASH_INIT, &ctx,
			       rsp_error_code_handle, &result);
	if (err < 0) {
		return err;
	}

	return result;
}

static void flash_remote_get_rsp(const struct nrf_rpc_group *group, struct nrf_rpc_cbor_ctx *ctx,
				 void *handler_data)
{
	int *result = (int *)handler_data;

	if (!zcbor_int32_decode(ctx->zs, result)) {
		LOG_ERR("Unable to decode result");
		*result = -EINVAL;
	}
}

static bool encode_flash_msg(struct nrf_rpc_cbor_ctx *ctx, off_t *offset, void *ptr, size_t *len)
{
	NRF_RPC_CBOR_ALLOC(&flash_netcore_api, *ctx, CBOR_BUF_FLASH_MSG_SIZE);

	if (!zcbor_uint32_put(ctx->zs, (uint32_t)*offset)) {
		return false;
	}

	if (!zcbor_uint32_put(ctx->zs, (uint32_t)ptr)) {
		return false;
	}

	return zcbor_uint32_put(ctx->zs, (uint32_t)*len);
}

int flash_remote_write(off_t offset, const void *data, size_t len)
{
	int err;
	int result;

	struct nrf_rpc_cbor_ctx ctx;

	if (data == NULL || len == 0) {
		return -EINVAL;
	}

	if (!encode_flash_msg(&ctx, &offset, (void *)data, &len)) {
		return -EINVAL;
	}

	err = nrf_rpc_cbor_cmd(&flash_netcore_api, RPC_COMMAND_FLASH_WRITE, &ctx,
			flash_remote_get_rsp, &result);

	LOG_DBG("offset: %x, data_ptr: %p, len: %d", (uint32_t)offset, data, (uint32_t)len);
	if (err) {
		LOG_ERR("Failed to send command: %d", err);
		return -NRF_EINVAL;
	}

	LOG_DBG("Write command sent: %d", result);

	return result;
}

int flash_remote_read(off_t offset, void *buffer, size_t len)
{
	int err;
	int result;

	struct nrf_rpc_cbor_ctx ctx;

	if (buffer == NULL || len == 0) {
		return -EINVAL;
	}

	if (!encode_flash_msg(&ctx, &offset, buffer, &len)) {
		return -EINVAL;
	}

	LOG_DBG("offset: %x, buffer_ptr: %p, len: %d", (uint32_t)offset, buffer, (uint32_t)len);

	err = nrf_rpc_cbor_cmd(&flash_netcore_api, RPC_COMMAND_FLASH_READ, &ctx,
				flash_remote_get_rsp, &result);
	if (err) {
		return -EINVAL;
	}

	LOG_DBG("Read command sent: %d", result);

	return result;
}

int flash_remote_erase(off_t offset, size_t size)
{
	int err;
	int result;

	struct nrf_rpc_cbor_ctx ctx;

	if (!encode_flash_msg(&ctx, &offset, NULL, &size)) {
		return -EINVAL;
	}

	err = nrf_rpc_cbor_cmd(&flash_netcore_api, RPC_COMMAND_FLASH_ERASE, &ctx,
				flash_remote_get_rsp, &result);
	if (err) {
		return -EINVAL;
	}

	LOG_DBG("Erase command sent: %d", result);

	return result;
}

static void err_handler(const struct nrf_rpc_err_report *report)
{
	LOG_ERR("nRF RPC error %d ocurred. See nRF RPC logs for more details.",
	       report->code);
	k_oops();
}

static int serialization_init(void)
{
	int err;

	LOG_INF("Init begin");

	err = nrf_rpc_init(err_handler);
	if (err) {
		LOG_ERR("Something went wrong");
		return -NRF_EINVAL;
	}

	LOG_INF("Init done");
	return 0;
}


SYS_INIT(serialization_init, POST_KERNEL, CONFIG_APPLICATION_INIT_PRIORITY);
```
